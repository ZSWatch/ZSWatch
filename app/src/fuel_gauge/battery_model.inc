/*
 * Copyright (c) 2023 Nordic Semiconductor ASA
 * SPDX-License-Identifier: LicenseRef-Nordic-5-Clause
 */

.param_1 = {0.0, 0.005, 0.01, 0.015, 0.02, 0.025, 0.03, 0.035, 0.04, 0.045, 0.05, 0.055, 0.06, 0.065, 0.07, 0.075, 0.08, 0.085, 0.09, 0.095, 0.1, 0.105, 0.11, 0.115, 0.12, 0.125, 0.13, 0.135, 0.14, 0.145, 0.15, 0.155, 0.16, 0.165, 0.17, 0.17500000000000002, 0.18, 0.185, 0.19, 0.195, 0.2, 0.20500000000000002, 0.21, 0.215, 0.22, 0.225, 0.23, 0.23500000000000001, 0.24, 0.245, 0.25, 0.255, 0.26, 0.265, 0.27, 0.275, 0.28, 0.28500000000000003, 0.29, 0.295, 0.3, 0.305, 0.31, 0.315, 0.32, 0.325, 0.33, 0.335, 0.34, 0.34500000000000003, 0.35000000000000003, 0.355, 0.36, 0.365, 0.37, 0.375, 0.38, 0.385, 0.39, 0.395, 0.4, 0.405, 0.41000000000000003, 0.41500000000000004, 0.42, 0.425, 0.43, 0.435, 0.44, 0.445, 0.45, 0.455, 0.46, 0.465, 0.47000000000000003, 0.47500000000000003, 0.48, 0.485, 0.49, 0.495, 0.5, 0.505, 0.51, 0.515, 0.52, 0.525, 0.53, 0.535, 0.54, 0.545, 0.55, 0.555, 0.56, 0.5650000000000001, 0.5700000000000001, 0.5750000000000001, 0.58, 0.585, 0.59, 0.595, 0.6, 0.605, 0.61, 0.615, 0.62, 0.625, 0.63, 0.635, 0.64, 0.645, 0.65, 0.655, 0.66, 0.665, 0.67, 0.675, 0.68, 0.685, 0.6900000000000001, 0.6950000000000001, 0.7000000000000001, 0.705, 0.71, 0.715, 0.72, 0.725, 0.73, 0.735, 0.74, 0.745, 0.75, 0.755, 0.76, 0.765, 0.77, 0.775, 0.78, 0.785, 0.79, 0.795, 0.8, 0.805, 0.81, 0.8150000000000001, 0.8200000000000001, 0.8250000000000001, 0.8300000000000001, 0.835, 0.84, 0.845, 0.85, 0.855, 0.86, 0.865, 0.87, 0.875, 0.88, 0.885, 0.89, 0.895, 0.9, 0.905, 0.91, 0.915, 0.92, 0.925, 0.93, 0.935, 0.9400000000000001, 0.9450000000000001, 0.9500000000000001, 0.9550000000000001, 0.96, 0.965, 0.97, 0.975, 0.98, 0.985, 0.99, 0.995, 1.0},
.temps = {25.0},
.param_2 = {2.99, 3.0, 3.0100000000000002, 3.02, 3.0300000000000002, 3.04, 3.0500000000000003, 3.06, 3.0700000000000003, 3.08, 3.0900000000000003, 3.1, 3.1100000000000003, 3.12, 3.1300000000000003, 3.14, 3.1500000000000004, 3.16, 3.1700000000000004, 3.18, 3.1900000000000004, 3.2, 3.2100000000000004, 3.22, 3.2300000000000004, 3.24, 3.25, 3.2600000000000002, 3.2700000000000005, 3.2800000000000002, 3.29, 3.3000000000000003, 3.31, 3.3200000000000003, 3.33, 3.3400000000000003, 3.35, 3.3600000000000003, 3.37, 3.3800000000000003, 3.39, 3.4000000000000004, 3.41, 3.4200000000000004, 3.43, 3.4400000000000004, 3.45, 3.4600000000000004, 3.47, 3.4800000000000004, 3.49, 3.5, 3.5100000000000002, 3.5200000000000005, 3.5300000000000002, 3.54, 3.5500000000000003, 3.5600000000000005, 3.5700000000000003, 3.58, 3.5900000000000003, 3.6, 3.6100000000000003, 3.62, 3.6300000000000003, 3.64, 3.6500000000000004, 3.66, 3.6700000000000004, 3.68, 3.6900000000000004, 3.7, 3.71, 3.72, 3.7300000000000004, 3.74, 3.75, 3.7600000000000002, 3.7700000000000005, 3.7800000000000002, 3.79, 3.8000000000000003, 3.8100000000000005, 3.8200000000000003, 3.83, 3.8400000000000003, 3.85, 3.8600000000000003, 3.87, 3.8800000000000003, 3.89, 3.9000000000000004, 3.91, 3.9200000000000004, 3.93, 3.9400000000000004, 3.95, 3.96, 3.97, 3.9800000000000004, 3.99, 4.0, 4.01, 4.0200000000000005, 4.03, 4.04, 4.050000000000001, 4.0600000000000005, 4.07, 4.08, 4.09, 4.1000000000000005, 4.11, 4.12, 4.130000000000001, 4.140000000000001, 4.15, 4.16, 4.17, 4.18, 4.19, 4.2},
.param_3 = {0.1299220770568989, 0.1318970152283605, 0.1336137475016624, 0.1351049342434311, 0.13640323582029273, 0.1375413125988738, 0.13855182494580062, 0.13946722684278498, 0.14030768660030082, 0.14107438554674245, 0.14176777627266265, 0.14239482070597537, 0.1429653697347046, 0.1434912207255421, 0.14398765275569309, 0.14446778746313177, 0.14492546019369276, 0.1453456626623033, 0.1457199695693217, 0.14605242191718198, 0.14634765790625323, 0.14660314542107486, 0.14681249480701472, 0.14697039377791946, 0.14707398248570006, 0.14712310655848906, 0.147140822453063, 0.1471632268074566, 0.1472109454355584, 0.1472685636051096, 0.14731697892381013, 0.1473513932798648, 0.14737547686097363, 0.1473930104567189, 0.147407774856683, 0.1474234138002302, 0.1474420206954329, 0.14746470872712225, 0.1474925756181666, 0.1475267190914343, 0.14756822797319452, 0.14761808094840934, 0.14767718231718518, 0.14774643498150958, 0.14782674184337025, 0.14791877715019636, 0.148020114453046, 0.14812609443361152, 0.14823200857136296, 0.14833314834577052, 0.14842507842161412, 0.1485074223067443, 0.14858291334050872, 0.14865436401491425, 0.1487245868219676, 0.14879628722790905, 0.14887042704967898, 0.14894654916322644, 0.14902415522610227, 0.14910274689585734, 0.14918181680537904, 0.14926069595069513, 0.14933857571527928, 0.14941464289245174, 0.14948808427553284, 0.1495581255383171, 0.14962475964518676, 0.14968868231631552, 0.1497506152141534, 0.14981128000115063, 0.14987140349167438, 0.14993182503501065, 0.14999349330101894, 0.15005736146843715, 0.15012438271600329, 0.1501954623646621, 0.15027034381359963, 0.1503475734920229, 0.15042564295976094, 0.1505030437766423, 0.1505783273790346, 0.15065167321850276, 0.15072504167245543, 0.15080048365425014, 0.15088005007724437, 0.15096570929369338, 0.15105689997557956, 0.1511501214123438, 0.15124170781266708, 0.15132799338523056, 0.15140540067868385, 0.1514734299752179, 0.15153538483067783, 0.1515948042899758, 0.15165522739802356, 0.15172014209853235, 0.15179099590234907, 0.15186655413100122, 0.15194539963693887, 0.1520261152726121, 0.1521072883802784, 0.1521877134367661, 0.1522664745330155, 0.15234267732883552, 0.152415427484035, 0.1524838508389288, 0.1525481618553443, 0.15261019560569125, 0.1526719190495844, 0.15273529914663883, 0.15280228635838922, 0.1528737764921855, 0.15294899226963507, 0.15302700791086266, 0.1531068976359927, 0.15318773404259572, 0.15326846495464183, 0.15334782712688122, 0.15342453692277158, 0.15349731070577083, 0.1535648804807836, 0.15362745931949606, 0.1536879383397783, 0.15374949035647775, 0.1538152881844414, 0.15388848165997263, 0.15397029602987441, 0.15405860825026377, 0.1541509598926527, 0.15424489252855297, 0.15433795764695038, 0.1544287486019324, 0.15451780227409756, 0.1546058680776624, 0.15469369542684355, 0.15478203079768288, 0.15487122361456437, 0.15496082875473038, 0.15505030645216672, 0.15513911694085925, 0.15522672360691653, 0.155313156146518, 0.1553996610372542, 0.15548764238801308, 0.1555785043076826, 0.15567364730427266, 0.1557735751613931, 0.15587672113064513, 0.1559812271564549, 0.15608523518324866, 0.15618689321388138, 0.1562855984343868, 0.15638351803043957, 0.15648319135194694, 0.15658715774881618, 0.15669795232263672, 0.15681687473561953, 0.15694228219961673, 0.15707210327009066, 0.15720426650250363, 0.15733670147816864, 0.1574677859907665, 0.15759704594114265, 0.15772418846801153, 0.15784892071008727, 0.15797095097895394, 0.15809082255076992, 0.15821137981404557, 0.15833586017217285, 0.1584675010285439, 0.1586095392127628, 0.15876445680061327, 0.1589324953309709, 0.1591134825086583, 0.15930724603849794, 0.15951361361634245, 0.15973240478769357, 0.1599634159136927, 0.16020643926065334, 0.16046126709488862, 0.16072769077037916, 0.16100387158494234, 0.16128297939358363, 0.16155723190552868, 0.16181884683000328, 0.16206004241861355, 0.16227543418538273, 0.16246753753885523, 0.16264049284150792, 0.16279844045581784, 0.16294552074426188, 0.16308587406931715, 0.16322364079346047, 0.16336296127916894, 0.1635079758889195, 0.16366282498518916, 0.1638316489304548, 0.16401858808719347, 0.16422778281788206, 0.16446337348499768, 0.16472950045101722},
.param_4 = {0.005196883082275956, 0.005275880609134421, 0.0053445499000664975, 0.005404197369737245, 0.005456129432811711, 0.005501652503954953, 0.005542072997832026, 0.0055786890737114, 0.005612307464012034, 0.0056429754218696995, 0.0056707110509065075, 0.0056957928282390154, 0.005718614789388186, 0.005739648829021685, 0.005759506110227725, 0.005778711498525272, 0.005797018407747712, 0.005813826506492133, 0.005828798782772869, 0.005842096876687281, 0.00585390631625013, 0.005864125816842996, 0.00587249979228059, 0.005878815751116779, 0.005882959299428004, 0.005884924262339564, 0.005885632898122522, 0.005886529072298266, 0.005888437817422338, 0.005890742544204385, 0.005892679156952406, 0.005894055731194593, 0.005895019074438946, 0.005895720418268757, 0.005896310994267321, 0.0058969365520092085, 0.005897680827817318, 0.005898588349084891, 0.005899703024726664, 0.005901068763657373, 0.005902729118927782, 0.005904723237936375, 0.005907087292687408, 0.0059098573992603836, 0.005913069673734811, 0.005916751086007856, 0.005920804578121841, 0.005925043777344462, 0.005929280342854519, 0.005933325933830822, 0.005937003136864566, 0.005940296892269773, 0.00594331653362035, 0.005946174560596571, 0.0059489834728787055, 0.005951851489116363, 0.005954817081987161, 0.005957861966529058, 0.005960966209044092, 0.005964109875834295, 0.005967272672215162, 0.005970427838027807, 0.005973543028611172, 0.005976585715698071, 0.005979523371021315, 0.0059823250215326855, 0.005984990385807472, 0.005987547292652621, 0.005990024608566137, 0.005992451200046027, 0.0059948561396669766, 0.0059972730014004275, 0.005999739732040758, 0.006002294458737487, 0.006004975308640133, 0.006007818494586485, 0.006010813752543987, 0.006013902939680918, 0.006017025718390438, 0.006020121751065694, 0.006023133095161385, 0.006026066928740112, 0.006029001666898219, 0.006032019346170006, 0.006035202003089776, 0.006038628371747737, 0.006042275999023184, 0.0060460048564937524, 0.006049668312506684, 0.006053119735409223, 0.006056216027147356, 0.006058937199008717, 0.006061415393227115, 0.006063792171599033, 0.006066209095920943, 0.006068805683941296, 0.006071639836093964, 0.006074662165240051, 0.006077815985477556, 0.006081044610904485, 0.006084291535211137, 0.0060875085374706445, 0.006090658981320621, 0.006093707093153422, 0.0060966170993614005, 0.006099354033557153, 0.006101926474213774, 0.0061044078242276515, 0.006106876761983378, 0.0061094119658655546, 0.00611209145433557, 0.006114951059687421, 0.006117959690785405, 0.006121080316434507, 0.0061242759054397095, 0.00612750936170383, 0.006130738598185674, 0.00613391308507525, 0.006136981476910865, 0.0061398924282308346, 0.006142595219231346, 0.006145098372779843, 0.006147517533591134, 0.006149979614259111, 0.006152611527377658, 0.006155539266398906, 0.0061588118411949775, 0.006162344330010552, 0.00616603839570611, 0.0061697957011421205, 0.006173518305878017, 0.006177149944077297, 0.006180712090963904, 0.006184234723106497, 0.006187747817073743, 0.006191281231907316, 0.0061948489445825755, 0.006198433150189216, 0.00620201225808667, 0.006205564677634372, 0.006209068944276662, 0.006212526245860721, 0.006215986441490169, 0.006219505695520524, 0.006223140172307305, 0.006226945892170908, 0.006230943006455725, 0.006235068845225807, 0.006239249086258197, 0.006243409407329948, 0.006247475728555257, 0.006251423937375473, 0.006255340721217585, 0.006259327654077879, 0.006263486309952648, 0.006267918092905471, 0.006272674989424782, 0.00627769128798467, 0.006282884130803627, 0.006288170660100147, 0.006293468059126747, 0.00629871143963066, 0.006303881837645707, 0.006308967538720463, 0.006313956828403492, 0.006318838039158159, 0.006323632902030798, 0.0063284551925618234, 0.0063334344068869146, 0.006338700041141758, 0.0063443815685105135, 0.006350578272024531, 0.006357299813238837, 0.0063645393003463335, 0.006372289841539918, 0.006380544544653699, 0.006389296191507744, 0.006398536636547709, 0.006408257570426135, 0.006418450683795545, 0.006429107630815167, 0.006440154863397695, 0.006451319175743347, 0.006462289276221148, 0.006472753873200132, 0.006482401696744544, 0.006491017367415311, 0.0064987015015542104, 0.006505619713660317, 0.006511937618232715, 0.006517820829770477, 0.006523434962772687, 0.00652894563173842, 0.006534518451166759, 0.006540319035556782, 0.006546512999407568, 0.006553265957218193, 0.00656074352348774, 0.006569111312715283, 0.006578534939399909, 0.00658918001804069},
.param_5 = {0.015799505371692953, 0.01476668177905413, 0.012831676060282363, 0.011157953274521307, 0.009745513421770876, 0.008594356502031504, 0.007703656975644683, 0.007023446618000841, 0.006428634815829927, 0.00584035868944734, 0.005281740636931594, 0.004790373848167877, 0.004385600078266917, 0.004089132083953846, 0.003906266950358742, 0.0037512297519986908, 0.003511500796686117, 0.003178037502515711, 0.0028270370195147485, 0.0025107533477261405, 0.002202894015571489, 0.001859347603045975, 0.0014689934273783359, 0.001045950714741433, 0.000610851122278492, 0.00026735986945174844, 0.00016048099587022066, 0.00028049192998163067, 0.00042134719061186557, 0.00042413395300684373, 0.00033131869902084873, 0.0002339917486539507, 0.00016646870741642353, 0.00012919198283754124, 0.00012161337404510697, 0.00013698335499965839, 0.000165179707568245, 0.00020221969093464284, 0.0002480414572482263, 0.00030260942011179834, 0.0003654474279001993, 0.00043581737596259246, 0.000513416132400836, 0.0005982381047402695, 0.0006893686747472261, 0.0007734904387030235, 0.000829269133660604, 0.00084757647326782, 0.0008282156486360409, 0.0007722794010046885, 0.000697095843895084, 0.0006313396755783587, 0.0005877668326798036, 0.0005666939258355645, 0.0005676928519791902, 0.0005833609108455741, 0.0006010477412695184, 0.0006149127056930513, 0.0006247909305237033, 0.0006306463171070267, 0.0006317962193511974, 0.0006270356396009986, 0.0006157877670263413, 0.0005980342410142822, 0.0005739305834614843, 0.0005467014786156993, 0.0005222271119935569, 0.0005034222758664927, 0.0004903907393405751, 0.0004831531100839802, 0.00048218013544007107, 0.0004883592373781769, 0.0005021457337059734, 0.0005235576599374285, 0.0005524035848998056, 0.0005838443903853976, 0.0006084445094432615, 0.0006211965846451319, 0.0006218811384775882, 0.0006107376770946894, 0.0005945177674417969, 0.0005868571736834111, 0.000595241742989451, 0.0006200336191556841, 0.000660902557773034, 0.0007073995933408461, 0.0007376484746015807, 0.0007392313483499738, 0.000711487891547069, 0.0006547714640672136, 0.0005817463599493838, 0.0005199366079758523, 0.00048549725903158925, 0.0004793702693828804, 0.0005013512342263125, 0.0005430740173020809, 0.0005856481298754587, 0.0006176149383591532, 0.0006382445664434265, 0.0006475549733581283, 0.000646392656615969, 0.0006367446109483733, 0.0006198555682777364, 0.000595811804077976, 0.0005646940403731225, 0.0005309374852373316, 0.0005053790670498347, 0.0004950287769604246, 0.0005004141637903088, 0.0005214692352191984, 0.000553909382186666, 0.0005868236449834557, 0.0006129256747085948, 0.0006316214654304882, 0.0006429045269322649, 0.0006462692745964373, 0.0006403723371420367, 0.0006242878725190755, 0.0005979343155584384, 0.0005613742320480924, 0.0005205944549008766, 0.0004922314359788287, 0.0004881241479267988, 0.0005093993786523844, 0.0005559652139794889, 0.0006200313817319829, 0.0006805063611645817, 0.0007226554511132258, 0.0007451371131568518, 0.0007479910171906932, 0.000735424293517653, 0.0007193785085886882, 0.0007084779029199739, 0.0007035726109839643, 0.000704650880081932, 0.0007101127508832294, 0.0007151918281899684, 0.0007163313504094347, 0.0007131527445155758, 0.0007056686189992056, 0.0006961568226349427, 0.000691749721350686, 0.0006979449659803155, 0.0007153730817136168, 0.0007440196650383528, 0.0007802834148419938, 0.0008122953054899053, 0.0008306079802472381, 0.0008340562104140921, 0.0008226642297059356, 0.0008014530045525464, 0.0007864992662327992, 0.0007903716702405833, 0.0008145588735063505, 0.0008590438827591612, 0.0009188679472134191, 0.000977319507919957, 0.0010209141378845002, 0.001047937211547719, 0.0010583928323119537, 0.0010540779530512911, 0.0010413778518960151, 0.001025609908980249, 0.0010074990757785382, 0.0009870500437695988, 0.000967607362730577, 0.000961715340366473, 0.0009801504856116368, 0.001024484857993415, 0.001094716162359892, 0.0011878230882773726, 0.0012918244728323328, 0.0013961028321802203, 0.0014990028301081412, 0.0016005244307365496, 0.0017006349967825518, 0.0017992091894010291, 0.0018961378918391086, 0.001991404724783607, 0.0020850060389032525, 0.0021704179602149987, 0.002221154492817925, 0.002213441282345255, 0.0021434697456785765, 0.00201124205233957, 0.0018263494215178463, 0.0016299804809666828, 0.0014602346245006469, 0.0013236116678504335, 0.001220111611015956, 0.0011497344539972143, 0.0011124801967942952, 0.0011083488394071986, 0.0011373403818361848, 0.0011994548240809068, 0.0012946921661411044, 0.0014230524080172113, 0.001584535549709054, 0.0017791415912168929, 0.002006870532540641, 0.0021290157281561237},
.param_6 = {0.39498763429232087, 0.3691670444763512, 0.3207919015070587, 0.2789488318630323, 0.24363783554427199, 0.21485891255078882, 0.19259142439111698, 0.17558616545002015, 0.1607158703957473, 0.14600896723618306, 0.13204351592329133, 0.1197593462041957, 0.10964000195667345, 0.10222830209884737, 0.0976566737589668, 0.0937807437999677, 0.08778751991715406, 0.07945093756289434, 0.0706759254878675, 0.06276883369315256, 0.05507235038928748, 0.04648369007614894, 0.03672483568445961, 0.026148767868533485, 0.015271278056960824, 0.006683996736295272, 0.004012024896754562, 0.007012298249539639, 0.010533679765298287, 0.01060334882517222, 0.008282967475520264, 0.0058497937163504155, 0.004161717685410848, 0.003229799570936276, 0.003040334351128715, 0.0034245838749918933, 0.004129492689206038, 0.005055492273367546, 0.006201036431205398, 0.0075652355027933105, 0.009136185697503074, 0.010895434399066373, 0.012835403310024196, 0.01495595261850613, 0.017234216868677876, 0.019337260967575154, 0.020731728341516487, 0.02118941183169576, 0.020705391215899982, 0.01930698502511652, 0.017427396097377534, 0.01578349188945949, 0.014694170816995089, 0.014167348145888159, 0.014192321299480448, 0.014584022771138572, 0.015026193531739174, 0.015372817642328451, 0.01561977326308972, 0.015766157927676883, 0.015794905483779154, 0.015675890990024532, 0.015394694175660528, 0.014950856025355841, 0.014348264586536152, 0.013667536965392135, 0.013055677799841958, 0.012585556896663186, 0.012259768483510736, 0.012078827752098897, 0.012054503386002557, 0.012208980934455549, 0.012553643342649856, 0.013088941498434759, 0.013810089622495747, 0.014596109759634768, 0.01521111273607989, 0.015529914616130291, 0.015547028461940227, 0.015268441927365761, 0.014862944186044835, 0.014671429342083542, 0.014881043574738184, 0.015500840478893663, 0.016522563944323942, 0.01768498983351907, 0.018441211865041773, 0.018480783708751947, 0.017787197288676726, 0.016369286601677913, 0.014543658998733555, 0.012998415199397262, 0.012137431475789384, 0.011984256734573484, 0.012533780855655818, 0.013576850432550636, 0.014641203246887335, 0.015440373458980305, 0.015956114161086443, 0.016188874333952774, 0.016159816415400874, 0.015918615273710635, 0.015496389206942629, 0.014895295101949313, 0.014117351009326762, 0.01327343713093121, 0.012634476676245954, 0.012375719424009834, 0.01251035409475798, 0.01303673088048074, 0.013847734554667257, 0.014670591124585353, 0.015323141867715218, 0.015790536635762464, 0.016072613173306882, 0.01615673186491362, 0.01600930842854953, 0.015607196812975066, 0.014948357888960873, 0.01403435580120127, 0.01301486137252339, 0.012305785899471844, 0.012203103698169016, 0.01273498446630883, 0.01389913034948731, 0.015500784543301394, 0.017012659029114197, 0.018066386277829083, 0.018628427828920602, 0.018699775429767418, 0.018385607337942367, 0.017984462714717986, 0.01771194757300143, 0.017589315274599282, 0.01761627200204674, 0.017752818772082124, 0.017879795704750512, 0.017908283760234567, 0.0178288186128861, 0.017641715474980835, 0.017403920565875475, 0.01729374303376663, 0.01744862414950754, 0.017884327042841375, 0.01860049162595856, 0.019507085371048283, 0.02030738263724685, 0.020765199506181387, 0.020851405260352562, 0.020566605742647348, 0.0200363251138147, 0.019662481655818853, 0.01975929175601354, 0.020363971837661365, 0.021476097068978683, 0.022971698680335217, 0.024432987698000397, 0.025522853447113025, 0.02619843028869029, 0.02645982080779763, 0.026351948826286442, 0.026034446297401592, 0.025640247724503795, 0.025187476894461547, 0.024676251094241097, 0.02419018406826512, 0.024042883509162172, 0.02450376214029326, 0.02561212144983338, 0.027367904058994696, 0.02969557720693683, 0.03229561182080953, 0.03490257080450421, 0.0374750707527044, 0.04001311076841374, 0.0425158749195631, 0.04498022973502547, 0.047403447295976675, 0.0497851181195913, 0.052125150972581746, 0.05426044900537219, 0.055528862320447514, 0.0553360320586338, 0.053586743641964585, 0.05028105130848726, 0.04565873553794564, 0.040749512024168544, 0.03650586561251834, 0.0330902916962611, 0.03050279027539682, 0.02874336134993105, 0.027812004919858246, 0.027708720985178403, 0.028433509545902624, 0.029986370602022583, 0.03236730415352995, 0.03557631020043028, 0.03961338874272635, 0.044478539780420934, 0.050171763313516804, 0.05322539320390951},
.param_7 = {-0.0, -0.0, -0.0, -0.0, -0.0, -0.0, -0.0, -0.0, -0.0, -0.0, -0.0, -0.0, -0.0, -0.0, -0.0, -0.0, -0.0, -0.0, -0.0, -0.0, -0.0, -0.0, -0.0, -0.0, -0.0, -0.0, -0.0, 2.726014827871891e-05, 6.763843163170183e-05, 0.00010801671498468301, 0.00014839499833766415, 0.00018877328169064704, 0.00023358417230008108, 0.00028003556972066917, 0.0003264869671412552, 0.0003729383645618432, 0.00042241915635444024, 0.000475896437809689, 0.0005293737192649355, 0.0005828510007201843, 0.000641867873889981, 0.000703290130870259, 0.0007647123878505347, 0.0008299939436096057, 0.0009000635686056611, 0.0009701331936017197, 0.0010454795742642579, 0.0011243946051735, 0.0012038526777018784, 0.0012909669969474492, 0.0013780813161930155, 0.0014712084190221261, 0.0015660905503541477, 0.0016670844945574233, 0.0017710948280292569, 0.0018833495984950735, 0.001998520480445669, 0.002125695858864398, 0.0022584545052075702, 0.002398397520936245, 0.002550046209407664, 0.002707967550307293, 0.0028710834940602376, 0.0030392310231441674, 0.003215127416459396, 0.0034061713264827496, 0.0036223607954924725, 0.003870838099874473, 0.004163864585117863, 0.004585648922486361, 0.006296421287985141, 0.008628888245639727, 0.009454447851039889, 0.01032886330408122, 0.01142067279467966, 0.012439115377603142, 0.013610427080704361, 0.01487569766744738, 0.015923457038514683, 0.016955959639753108, 0.017848525769070343, 0.019074052894390327, 0.02009035740114929, 0.021191076445437114, 0.022380289068091943, 0.02338033485905311, 0.02457436916253643, 0.02556419613157401, 0.026436990118674997, 0.027336726471229904, 0.02824331794870222, 0.02910784168771883, 0.029879923420794284, 0.030678512175237028, 0.0313599912226432, 0.031966462655816125, 0.03258540835578722, 0.033239954062758106, 0.033856820157485666, 0.034359601989925936, 0.034780985910752245, 0.03515414607610232, 0.03549163866863326, 0.03580416725189261, 0.03609779469719258, 0.03638471834477571, 0.03668195997738435, 0.03701555296073624, 0.03742384124540005, 0.03793084775610587, 0.03850350629421154, 0.039026637378912564, 0.03945045011795685, 0.03979147103445483, 0.0399361022364217, 0.0399361022364217, 0.0399361022364217, 0.0399361022364217, 0.0399361022364217, 0.0399361022364217, 0.0399361022364217, 0.0399361022364217},
.param_8 = {0.0, 0.0, 0.0, 0.0, 0.0, 0.0, 0.0, 0.0, 0.0, 0.0, 0.0, 0.0, 0.0, 0.0, 0.0, 0.0, 0.0, 0.0, 0.0, 0.0, 0.0, 0.0, 0.0, 0.0, 0.0, 0.0, 0.0, 1.0904059311487566e-06, 2.7055372652680742e-06, 4.320668599387321e-06, 5.935799933506567e-06, 7.550931267625884e-06, 9.343366892003246e-06, 1.1201422788826769e-05, 1.305947868565021e-05, 1.4917534582473731e-05, 1.6896766254177614e-05, 1.9035857512387564e-05, 2.1174948770597423e-05, 2.3314040028807377e-05, 2.5674714955599245e-05, 2.8131605234810368e-05, 3.0588495514021395e-05, 3.319975774438423e-05, 3.600254274422645e-05, 3.8805327744068794e-05, 4.181918297057032e-05, 4.497578420694001e-05, 4.815410710807515e-05, 5.1638679877897974e-05, 5.512325264772063e-05, 5.884833676088506e-05, 6.264362201416593e-05, 6.668337978229694e-05, 7.084379312117029e-05, 7.533398393980294e-05, 7.994081921782678e-05, 8.502783435457593e-05, 9.033818020830283e-05, 9.593590083744982e-05, 0.0001020018483763066, 0.00010831870201229175, 0.00011484333976240952, 0.00012156924092576671, 0.00012860509665837586, 0.00013624685305931, 0.00014489443181969893, 0.00015483352399497894, 0.00016655458340471456, 0.00018342595689945448, 0.00025185685151940567, 0.00034515552982558915, 0.0003781779140415956, 0.0004131545321632488, 0.0004568269117871865, 0.0004975646151041258, 0.0005444170832281745, 0.0005950279066978954, 0.0006369382815405874, 0.0006782383855901245, 0.0007139410307628138, 0.0007629621157756132, 0.0008036142960459718, 0.0008476430578174847, 0.0008952115627236778, 0.0009352133943621246, 0.0009829747665014573, 0.0010225678452629606, 0.001057479604747, 0.0010934690588491965, 0.001129732717948089, 0.0011643136675087533, 0.0011951969368317716, 0.0012271404870094814, 0.0012543996489057284, 0.001278658506232645, 0.001303416334231489, 0.0013295981625103246, 0.0013542728062994269, 0.0013743840795970377, 0.00139123943643009, 0.001406165843044093, 0.0014196655467453307, 0.0014321666900757046, 0.0014439117878877034, 0.0014553887337910288, 0.001467278399095374, 0.0014806221184294499, 0.0014969536498160023, 0.001517233910244235, 0.0015401402517684617, 0.0015610654951565028, 0.0015780180047182744, 0.0015916588413781936, 0.0015974440894568685, 0.0015974440894568685, 0.0015974440894568685, 0.0015974440894568685, 0.0015974440894568685, 0.0015974440894568685, 0.0015974440894568685, 0.0015974440894568685},
.param_9 = {1.8232226292464735},
.param_10 = {1110.7214904863413, 9.285274962677075},
.param_11 = {2.1819044922278756, 0.016907295574778852},
.param_12 = {0.29978963276131065},
.name = {'z', 's', 'w', 'a', 't', 'c', 'h', '1'},

/*
 * Copyright (c) 2023 Nordic Semiconductor ASA
 * SPDX-License-Identifier: LicenseRef-Nordic-5-Clause
 */

.param_1 = {0.0, 0.005, 0.01, 0.015, 0.02, 0.025, 0.03, 0.035, 0.04, 0.045, 0.05, 0.055, 0.06, 0.065, 0.07, 0.075, 0.08, 0.085, 0.09, 0.095, 0.1, 0.105, 0.11, 0.115, 0.12, 0.125, 0.13, 0.135, 0.14, 0.145, 0.15, 0.155, 0.16, 0.165, 0.17, 0.17500000000000002, 0.18, 0.185, 0.19, 0.195, 0.2, 0.20500000000000002, 0.21, 0.215, 0.22, 0.225, 0.23, 0.23500000000000001, 0.24, 0.245, 0.25, 0.255, 0.26, 0.265, 0.27, 0.275, 0.28, 0.28500000000000003, 0.29, 0.295, 0.3, 0.305, 0.31, 0.315, 0.32, 0.325, 0.33, 0.335, 0.34, 0.34500000000000003, 0.35000000000000003, 0.355, 0.36, 0.365, 0.37, 0.375, 0.38, 0.385, 0.39, 0.395, 0.4, 0.405, 0.41000000000000003, 0.41500000000000004, 0.42, 0.425, 0.43, 0.435, 0.44, 0.445, 0.45, 0.455, 0.46, 0.465, 0.47000000000000003, 0.47500000000000003, 0.48, 0.485, 0.49, 0.495, 0.5, 0.505, 0.51, 0.515, 0.52, 0.525, 0.53, 0.535, 0.54, 0.545, 0.55, 0.555, 0.56, 0.5650000000000001, 0.5700000000000001, 0.5750000000000001, 0.58, 0.585, 0.59, 0.595, 0.6, 0.605, 0.61, 0.615, 0.62, 0.625, 0.63, 0.635, 0.64, 0.645, 0.65, 0.655, 0.66, 0.665, 0.67, 0.675, 0.68, 0.685, 0.6900000000000001, 0.6950000000000001, 0.7000000000000001, 0.705, 0.71, 0.715, 0.72, 0.725, 0.73, 0.735, 0.74, 0.745, 0.75, 0.755, 0.76, 0.765, 0.77, 0.775, 0.78, 0.785, 0.79, 0.795, 0.8, 0.805, 0.81, 0.8150000000000001, 0.8200000000000001, 0.8250000000000001, 0.8300000000000001, 0.835, 0.84, 0.845, 0.85, 0.855, 0.86, 0.865, 0.87, 0.875, 0.88, 0.885, 0.89, 0.895, 0.9, 0.905, 0.91, 0.915, 0.92, 0.925, 0.93, 0.935, 0.9400000000000001, 0.9450000000000001, 0.9500000000000001, 0.9550000000000001, 0.96, 0.965, 0.97, 0.975, 0.98, 0.985, 0.99, 0.995, 1.0},
.temps = {25.0},
.param_2 = {2.99, 3.001652892561984, 3.013305785123967, 3.0249586776859507, 3.036611570247934, 3.0482644628099176, 3.0599173553719012, 3.0715702479338844, 3.083223140495868, 3.0948760330578513, 3.106528925619835, 3.118181818181818, 3.129834710743802, 3.1414876033057855, 3.1531404958677687, 3.1647933884297523, 3.176446280991736, 3.188099173553719, 3.199752066115703, 3.211404958677686, 3.2230578512396697, 3.234710743801653, 3.2463636363636366, 3.25801652892562, 3.2696694214876034, 3.281322314049587, 3.2929752066115707, 3.304628099173554, 3.3162809917355376, 3.327933884297521, 3.3395867768595044, 3.3512396694214877, 3.3628925619834713, 3.374545454545455, 3.386198347107438, 3.397851239669422, 3.409504132231405, 3.4211570247933887, 3.432809917355372, 3.4444628099173555, 3.456115702479339, 3.4677685950413224, 3.479421487603306, 3.4910743801652897, 3.502727272727273, 3.5143801652892566, 3.5260330578512398, 3.5376859504132234, 3.5493388429752066, 3.5609917355371903, 3.572644628099174, 3.584297520661157, 3.595950413223141, 3.6076033057851244, 3.6192561983471077, 3.6309090909090913, 3.6425619834710745, 3.654214876033058, 3.6658677685950414, 3.677520661157025, 3.6891735537190087, 3.700826446280992, 3.7124793388429755, 3.724132231404959, 3.7357851239669424, 3.7474380165289256, 3.7590909090909093, 3.770743801652893, 3.782396694214876, 3.7940495867768598, 3.8057024793388434, 3.8173553719008266, 3.8290082644628103, 3.8406611570247935, 3.852314049586777, 3.8639669421487604, 3.875619834710744, 3.8872727272727277, 3.898925619834711, 3.9105785123966945, 3.922231404958678, 3.9338842975206614, 3.945537190082645, 3.9571900826446282, 3.968842975206612, 3.980495867768595, 3.9921487603305787, 4.003801652892562, 4.015454545454546, 4.027107438016529, 4.038760330578513, 4.050413223140496, 4.062066115702479, 4.073719008264463, 4.085371900826447, 4.09702479338843, 4.108677685950413, 4.120330578512397, 4.13198347107438, 4.1436363636363645, 4.155289256198348, 4.166942148760331, 4.178595041322314, 4.190247933884297, 4.201900826446281, 4.213553719008265, 4.225206611570249, 4.236859504132232, 4.248512396694215, 4.260165289256198, 4.271818181818182, 4.283471074380166, 4.295123966942149, 4.306776859504133, 4.318429752066116, 4.330082644628099, 4.3417355371900825, 4.353388429752067, 4.36504132231405, 4.376694214876033, 4.388347107438017, 4.4},
.param_3 = {0.08465246112468988, 0.10965559917312581, 0.12522898158821613, 0.13364875650000183, 0.13719107203852376, 0.13813207633382288, 0.13868872163556392, 0.13970963043177667, 0.1406911096550949, 0.1414455157200681, 0.14211594182945242, 0.14276789332677572, 0.14339471136819607, 0.14397731296248933, 0.14449116580178709, 0.1449340142179776, 0.14531886678943323, 0.1456691184411909, 0.14601031887981292, 0.14633804377407653, 0.14663284446054906, 0.14687516071778295, 0.14704950259613442, 0.14716431511747186, 0.14723676355018248, 0.14728402578148683, 0.14732102730477042, 0.14735327365512313, 0.14738380815195196, 0.14741567313136292, 0.1474505275567393, 0.1474858909896273, 0.14751851207339264, 0.14754515973987453, 0.14756642136127732, 0.14759117808226876, 0.14762939908715753, 0.14769093915246476, 0.1477782125766674, 0.14788175692134634, 0.14799104680266542, 0.14809578339647828, 0.14819291027801726, 0.1482879622849199, 0.1483869730563807, 0.14849561889505478, 0.14861291346086658, 0.1487319723449963, 0.1488457074294358, 0.14894780922901826, 0.14904129592338036, 0.14913533727111988, 0.14923921173630667, 0.1493606948817769, 0.14949532388313644, 0.14963267453369686, 0.14976228265498237, 0.14987562021185705, 0.14997524139651064, 0.15006763667800505, 0.1501593012277985, 0.15025526916648824, 0.1503545932798249, 0.15045479593638664, 0.15055340057013983, 0.15064924301688148, 0.15074502710151708, 0.15084416572587206, 0.15095005882918242, 0.15106375875884331, 0.1511812642862192, 0.1512979180683621, 0.15140910114879624, 0.1515126841851651, 0.15161050792926262, 0.15170476798114593, 0.1517976624724549, 0.15189147118652357, 0.15198857118354053, 0.15209134521037476, 0.15220197351742412, 0.1523187995012039, 0.15243673680125785, 0.1525505783012739, 0.15265561033666086, 0.15275314283949293, 0.15284851281232906, 0.15294713099851295, 0.15305375470602423, 0.15316770187852358, 0.15328559149757556, 0.15340402310334764, 0.15352015992528753, 0.1536344668332435, 0.1537486071235159, 0.1538642457801462, 0.15398226653651226, 0.15410027637733467, 0.15421502333950704, 0.1543232565979709, 0.15442348606448336, 0.15451953604121374, 0.15461622952950937, 0.15471837828442872, 0.15482855523129288, 0.15494440774683493, 0.15506292740018135, 0.15518112512710552, 0.15529733911506935, 0.15541206589660655, 0.15552600000962305, 0.15563983004471993, 0.15575404506932436, 0.1558688919313379, 0.15598460289130386, 0.15610136242175815, 0.15621842269885886, 0.15633418782483163, 0.1564470310057364, 0.15655568187891286, 0.156663330032997, 0.1567762001966348, 0.15690057526826548, 0.15704152457980727, 0.15719381266217541, 0.1573470054660149, 0.15749062907952674, 0.15761639410216877, 0.15772903141242534, 0.157838075862973, 0.15795306991432084, 0.15808180667691832, 0.15822463893666971, 0.15837994174701134, 0.15854608997062328, 0.15872115432475284, 0.15890227657694997, 0.1590864217618659, 0.15927056008150917, 0.15945272972951183, 0.15963333837011764, 0.15981311221212408, 0.15999277441714319, 0.16017283656592904, 0.16035346459376937, 0.1605347925341409, 0.16071702036052576, 0.1609025585556567, 0.16109650017694713, 0.16130409974506066, 0.16153043386058902, 0.16177713741302277, 0.16204273030244817, 0.16232562005707638, 0.16262374188819095, 0.16292919652580665, 0.16323015056622517, 0.16351469696039792, 0.16377255132119423, 0.1640069774804709, 0.16422797873525002, 0.16444560739774614, 0.16466782078312459, 0.16489033385049603, 0.16510442752379584, 0.16530137658211025, 0.1654757465644344, 0.16563579147675633, 0.16579332399982902, 0.1659601538963667, 0.16614417582628768, 0.16634164080156766, 0.16654664508608902, 0.16675329236470898, 0.16695703624398806, 0.16715623926686946, 0.16734964210275782, 0.1675360178221507, 0.16771620903602608, 0.16789434045007992, 0.1680748279677435, 0.1682619796680133, 0.1684566957012051, 0.1686558557501551, 0.16885610811529198, 0.1690542614215438, 0.1692500894417557, 0.16944597792620264, 0.1696444019592529, 0.16984771591806003, 0.17005684019137424, 0.17027175519205892, 0.17049242498712738, 0.17071881364359318, 0.17095088522846968, 0.17118860380877043, 0.17143193345150873, 0.17168083822369806, 0.17193528219235188, 0.1721952294244837, 0.1724606439871068},
.param_4 = {0.0033860984449875955, 0.004386223966925033, 0.005009159263528646, 0.005345950260000074, 0.005487642881540951, 0.005525283053352916, 0.005547548865422558, 0.005588385217271068, 0.005627644386203797, 0.005657820628802726, 0.0056846376731780985, 0.00571071573307103, 0.005735788454727844, 0.005759092518499574, 0.005779646632071485, 0.005797360568719105, 0.00581275467157733, 0.005826764737647638, 0.005840412755192518, 0.005853521750963062, 0.005865313778421964, 0.0058750064287113185, 0.005881980103845378, 0.005886572604698875, 0.0058894705420073, 0.0058913610312594745, 0.005892841092190819, 0.005894130946204926, 0.00589535232607808, 0.005896626925254518, 0.005898021102269573, 0.005899435639585094, 0.005900740482935706, 0.005901806389594983, 0.005902656854451093, 0.0059036471232907515, 0.005905175963486302, 0.005907637566098591, 0.0059111285030666975, 0.005915270276853854, 0.005919641872106618, 0.005923831335859132, 0.005927716411120691, 0.005931518491396797, 0.00593547892225523, 0.005939824755802192, 0.005944516538434664, 0.005949278893799852, 0.005953828297177433, 0.005957912369160732, 0.005961651836935216, 0.005965413490844796, 0.005969568469452268, 0.005974427795271077, 0.005979812955325459, 0.0059853069813478755, 0.005990491306199296, 0.005995024808474284, 0.005999009655860427, 0.006002705467120203, 0.0060063720491119405, 0.00601021076665953, 0.006014183731192997, 0.006018191837455466, 0.006022136022805594, 0.00602596972067526, 0.006029801084060684, 0.0060337666290348835, 0.006038002353167298, 0.006042550350353734, 0.006047250571448769, 0.006051916722734484, 0.006056364045951851, 0.006060507367406605, 0.006064420317170506, 0.006068190719245839, 0.006071906498898197, 0.006075658847460945, 0.0060795428473416225, 0.006083653808414992, 0.006088078940696966, 0.006092751980048158, 0.006097469472050315, 0.006102023132050957, 0.006106224413466436, 0.006110125713579718, 0.006113940512493164, 0.00611788523994052, 0.0061221501882409695, 0.0061267080751409445, 0.006131423659903024, 0.006136160924133906, 0.006140806397011502, 0.006145378673329741, 0.006149944284940637, 0.006154569831205849, 0.006159290661460492, 0.006164011055093389, 0.006168600933580282, 0.0061729302639188365, 0.006176939442579336, 0.006180781441648551, 0.006184649181180377, 0.0061887351313771495, 0.006193142209251716, 0.006197776309873398, 0.006202517096007255, 0.006207245005084222, 0.006211893564602775, 0.006216482635864264, 0.006221040000384924, 0.006225593201788799, 0.006230161802772975, 0.006234755677253517, 0.006239384115652156, 0.006244054496870328, 0.006248736907954355, 0.006253367512993267, 0.006257881240229457, 0.006262227275156515, 0.006266533201319882, 0.006271048007865394, 0.00627602301073062, 0.006281660983192292, 0.006287752506487018, 0.006293880218640597, 0.00629962516318107, 0.0063046557640867515, 0.006309161256497014, 0.00631352303451892, 0.006318122796572834, 0.006323272267076734, 0.00632898555746679, 0.006335197669880454, 0.006341843598824932, 0.006348846172990114, 0.006356091063078, 0.006363456870474637, 0.006370822403260368, 0.006378109189180475, 0.0063853335348047074, 0.0063925244884849635, 0.006399710976685729, 0.006406913462637162, 0.006414138583750776, 0.006421391701365638, 0.0064286808144210315, 0.006436102342226269, 0.006443860007077887, 0.006452163989802427, 0.006461217354423562, 0.006471085496520913, 0.006481709212097928, 0.006493024802283057, 0.006504949675527639, 0.006517167861032267, 0.006529206022649008, 0.006540587878415918, 0.00655090205284777, 0.006560279099218838, 0.006569119149410002, 0.006577824295909847, 0.006586712831324984, 0.006595613354019842, 0.006604177100951835, 0.006612055063284411, 0.006619029862577377, 0.006625431659070254, 0.006631732959993163, 0.006638406155854669, 0.006645767033051509, 0.006653665632062707, 0.006661865803443562, 0.006670131694588361, 0.006678281449759523, 0.006686249570674779, 0.006693985684110315, 0.006701440712886029, 0.006708648361441044, 0.0067157736180031985, 0.006722993118709742, 0.006730479186720532, 0.0067382678280482056, 0.006746234230006205, 0.00675424432461168, 0.006762170456861754, 0.0067700035776702295, 0.006777839117048107, 0.006785776078370118, 0.006793908636722402, 0.00680227360765497, 0.0068108702076823575, 0.006819696999485096, 0.006828752545743728, 0.006838035409138789, 0.006847544152350818, 0.00685727733806035, 0.006867233528947923, 0.006877411287694077, 0.006887809176979349, 0.006898425759484273},
.param_5 = {0.20002510438748747, 0.16230608185410503, 0.0959726293075041, 0.047848361801230546, 0.01793327933528417, 0.005990598388160625, 0.0063102163918152265, 0.008009552078123896, 0.006943541153165821, 0.0056993286974301935, 0.005289510426830391, 0.0051150781549745734, 0.00483767854285444, 0.004385817734364056, 0.0038268050219530947, 0.003310803950584522, 0.0029404168928532856, 0.002765808361518754, 0.0026757013315423933, 0.002490102322944606, 0.002148467774825639, 0.001666632542341416, 0.0011566175987556306, 0.0007490438161922297, 0.0004788426560599704, 0.0003370550183518471, 0.00027699149454515556, 0.0002511233887261301, 0.0002495979049592194, 0.0002668776191492965, 0.0002808714330575571, 0.0002719380666133149, 0.00023707500098890666, 0.00019163715153872746, 0.0001840733695768551, 0.0002519109035209119, 0.00039904428078395976, 0.0005952539580395162, 0.0007632710755263276, 0.0008513369039920074, 0.0008561059005277906, 0.0008074539014073234, 0.000768715553766449, 0.0007762511134538908, 0.0008306264405395607, 0.0009037616179434667, 0.000945413799766006, 0.0009311758742768829, 0.000863347536087921, 0.0007823539757782424, 0.000750112168406477, 0.0007916632517051929, 0.0009014304426280956, 0.0010244485873191038, 0.0010879186076798164, 0.0010678350873837006, 0.0009717827126408396, 0.000851834966113154, 0.0007680658645919415, 0.0007362393251513291, 0.0007505299539327034, 0.0007811682081056495, 0.0007981070795935741, 0.0007952291612597223, 0.0007777883219793787, 0.0007665061255089992, 0.0007796908359623649, 0.0008201269106613944, 0.0008783721318850191, 0.0009248218281470919, 0.0009366372380750602, 0.0009113474503081621, 0.0008590644672120534, 0.0008056271218655382, 0.0007683351839234479, 0.000748618172769118, 0.0007468128215105257, 0.0007636348443425256, 0.0007994960954047121, 0.0008536093355343381, 0.0009098171633165932, 0.0009390531353349087, 0.0009271152002799168, 0.000875494141612098, 0.0008102581528761192, 0.0007716099026728283, 0.0007759526360801711, 0.0008209675747805276, 0.0008822835200424789, 0.0009273471662054646, 0.0009452848992961942, 0.0009382737108478041, 0.0009217749195834443, 0.000913788792913494, 0.0009191157876108427, 0.0009346376519854711, 0.0009441223887539374, 0.0009310272119790464, 0.0008919208825447847, 0.0008338508999053938, 0.0007851177729714318, 0.0007709738601040413, 0.0007953689728598667, 0.0008493028071339566, 0.0009041178496248595, 0.0009374886755539151, 0.0009468695210824128, 0.0009376468595519334, 0.0009237630780041528, 0.0009146435782148889, 0.0009110565924535206, 0.000912180238805179, 0.0009162475464718003, 0.00092223128791806, 0.0009298819616810651, 0.0009352792302199341, 0.0009313016122939298, 0.0009144332275101523, 0.0008859762163248262, 0.0008651961090425271, 0.0008820732708878475, 0.0009489809410737765, 0.001061297532689836, 0.0011729495756397992, 0.0012219235448304895, 0.0011872656694052013, 0.0010775545446154583, 0.0009536093315944474, 0.0008867270432168922, 0.0008961540075820042, 0.0009749232557814021, 0.0010862760893955853, 0.0011925402803719502, 0.0012858041358141878, 0.0013648503109660488, 0.001424746425306763, 0.0014610697484522366, 0.0014731340182367984, 0.0014652318705838177, 0.0014511131544339695, 0.0014415299304488573, 0.001437744188102167, 0.0014388974152198739, 0.0014427607065046685, 0.0014478238728475416, 0.0014542230670255667, 0.00147106408606313, 0.001517919265685546, 0.0016061647576158002, 0.0017357347345674755, 0.0018921506718485616, 0.002049185767436651, 0.0021939305762144236, 0.0023240463429711165, 0.0024143058749210265, 0.0024256347121368385, 0.0023420017383650633, 0.002169603019876263, 0.001969122080291985, 0.001821709656223136, 0.001754519669100972, 0.001759368191498259, 0.001778905810999494, 0.0017464269626850382, 0.0016441709264568803, 0.0014852761625542242, 0.0013376595785843243, 0.00127030974157857, 0.0012974496784414619, 0.0014034073058346273, 0.0015259476208038386, 0.0016098770392053083, 0.0016466062525653628, 0.0016415646315961346, 0.001611787608641821, 0.0015704234350791442, 0.0015191142211250057, 0.0014662677330729186, 0.0014332905117169295, 0.0014344757268697737, 0.0014705568717333917, 0.0015274709338463852, 0.0015755043285672898, 0.0015976496563474378, 0.0015936226855548484, 0.0015759253058549548, 0.0015668660186353434, 0.0015772500699888503, 0.0016069519674294548, 0.0016497529284851924, 0.0016961570959955763, 0.0017423391830126422, 0.0017882338061370878, 0.00183384096536926, 0.0018791606607089853, 0.0019241928921560902, 0.001968937659710488, 0.0020133949633726993, 0.0020575648031425503, 0.0021014471790196075, 0.002123316500984851},
.param_6 = {5.000627609687186, 4.057652046352625, 2.3993157326876013, 1.1962090450307632, 0.44833198338210534, 0.1497649597040157, 0.15775540979537928, 0.20023880195309818, 0.17358852882914388, 0.14248321743575154, 0.13223776067076143, 0.1278769538743646, 0.120941963571361, 0.10964544335910209, 0.09567012554882737, 0.08277009876461461, 0.07351042232132954, 0.0691452090379685, 0.06689253328856226, 0.06225255807361385, 0.05371169437064227, 0.04166581355853627, 0.028915439968890677, 0.018726095404805743, 0.011971066401497699, 0.008426375458794877, 0.00692478736362967, 0.006278084718153165, 0.0062399476239788365, 0.00667194047873354, 0.007021785826438753, 0.0067984516653352145, 0.0059268750247226665, 0.004790928788467319, 0.004601834239423286, 0.006297772588020889, 0.009976107019599167, 0.014881348950987472, 0.01908177688815793, 0.021283422599802093, 0.021402647513193984, 0.02018634753518378, 0.019217888844161313, 0.019406277836345187, 0.020765661013488756, 0.022594040448586927, 0.02363534499415232, 0.023279396856920598, 0.021583688402196377, 0.019558849394457622, 0.01875280421016201, 0.019791581292630256, 0.022535761065700655, 0.025611214682977335, 0.027197965191996798, 0.02669587718459321, 0.024294567816018908, 0.021295874152826855, 0.01920164661479984, 0.01840598312878583, 0.018763248848319147, 0.019529205202639677, 0.019952676989840046, 0.019880729031493405, 0.019444708049484727, 0.019162653137724805, 0.019492270899057473, 0.020503172766533906, 0.021959303297125476, 0.023120545703678164, 0.023415930951878328, 0.02278368625770466, 0.021476611680298907, 0.020140678046637328, 0.019208379598084635, 0.018715454319229163, 0.018670320537764185, 0.019090871108562446, 0.019987402385118758, 0.021340233388358887, 0.02274542908291266, 0.023476328383373324, 0.02317788000699983, 0.021887353540300802, 0.020256453821904108, 0.019290247566819407, 0.019398815902002542, 0.020524189369516832, 0.02205708800106232, 0.023183679155133752, 0.02363212248240598, 0.02345684277119675, 0.02304437298958628, 0.02284471982283709, 0.022977894690270895, 0.02336594129963565, 0.023603059718846353, 0.02327568029947824, 0.022298022063621525, 0.020846272497632157, 0.019627944324285274, 0.01927434650260129, 0.019884224321498056, 0.021232570178350563, 0.022602946240621313, 0.023437216888846923, 0.02367173802705902, 0.023441171488799983, 0.023094076950103126, 0.022866089455370053, 0.02277641481133741, 0.02280450597013095, 0.02290618866179761, 0.02305578219795046, 0.02324704904202446, 0.023381980755499132, 0.02328254030734833, 0.02286083068775424, 0.022149405408122824, 0.021629902726061356, 0.022051831772193498, 0.02372452352684684, 0.02653243831724772, 0.02932373939099342, 0.030548088620763192, 0.029681641735132547, 0.02693886361538611, 0.023840233289859625, 0.022168176080422652, 0.02240385018955071, 0.024373081394532536, 0.027156902234887204, 0.029813507009301965, 0.032145103395356256, 0.03412125777415009, 0.035618660632669163, 0.03652674371130704, 0.0368283504559197, 0.0366307967645918, 0.03627782886084785, 0.036038248261224815, 0.03594360470255409, 0.035972435380496326, 0.036069017662618275, 0.03619559682118689, 0.0363555766756396, 0.036776602151578075, 0.03794798164213631, 0.040154118940397, 0.043393368364189056, 0.04730376679621118, 0.05122964418591558, 0.0548482644053605, 0.058101158574278, 0.06035764687302714, 0.06064086780342148, 0.058550043459126844, 0.05424007549690579, 0.04922805200729963, 0.04554274140557979, 0.043862991727522394, 0.04398420478745613, 0.04447264527498995, 0.04366067406712526, 0.0411042731614214, 0.03713190406385569, 0.033441489464608454, 0.03175774353946226, 0.032436241961036893, 0.035085182645866464, 0.03814869052009562, 0.040246925980133574, 0.04116515631413242, 0.04103911578990371, 0.04029469021604726, 0.039260585876976783, 0.037977855528123494, 0.03665669332682531, 0.035832262792923064, 0.03586189317174304, 0.03676392179333687, 0.038186773346160496, 0.03938760821418086, 0.03994124140868638, 0.0398405671388713, 0.03939813264637326, 0.03917165046588289, 0.039431251749719176, 0.04017379918573871, 0.04124382321213371, 0.04240392739988941, 0.04355847957531467, 0.04470584515342546, 0.04584602413423011, 0.04697901651772585, 0.04810482230390434, 0.04922344149276281, 0.05033487408431514, 0.051439120078564105, 0.05253617947549305, 0.05308291252462127},
.param_7 = {0.0003247370445476355, 0.000330703991123457, 0.0003366709376992783, 0.00034263788427509983, 0.0003486048308509212, 0.0003545717774267426, 0.0003605387240025642, 0.00036650567057838545, 0.000372472617154207, 0.00037843956373002837, 0.00038440651030584983, 0.00039037345688167123, 0.00039634040345749264, 0.000404810608367613, 0.00041584719091872186, 0.0004268837734698312, 0.0004379203560209405, 0.0004489569385720494, 0.0004599935211231587, 0.00047103010367426757, 0.0004820666862253769, 0.0004931032687764857, 0.000504139851327595, 0.0005151764338787045, 0.0005262130164298134, 0.0005372495989809225, 0.000548286181532032, 0.000559322764083141, 0.00057035934663425, 0.000581395929185359, 0.0005924325117364685, 0.0006095654590532987, 0.0006357984526602025, 0.0006620314462671063, 0.0006882644398740094, 0.0007144974334809132, 0.0007407304270878161, 0.0007669634206947199, 0.0007931964143016229, 0.0008766728200023608, 0.0009754242724026358, 0.0011264964734790939, 0.0012500732155466053, 0.0013410955881820483, 0.0014334981007109616, 0.001528177171513416, 0.0016305051970074529, 0.0017536822831818312, 0.0018868472296767315, 0.002026265747822937, 0.002168800186745477, 0.0023159397138327203, 0.002469351950389313, 0.0026332688963334313, 0.002817089101483791, 0.0030317048018564537, 0.0032808949070624854, 0.003550228251441085, 0.0038362135321426956, 0.0041856109119336885, 0.0052547617281141065, 0.007623286555370048, 0.008531625970439733, 0.009377190593477447, 0.01029396944335623, 0.011021550130760853, 0.011902708696191354, 0.012853325530704377, 0.013761134891474135, 0.01459069647130073, 0.015567578203663043, 0.01639758225400037, 0.017308493667188982, 0.018132170374422312, 0.018938846485766554, 0.019747195187846248, 0.020673608182103596, 0.02147130604846533, 0.022283528784520192, 0.02308590670213684, 0.023915852475080556, 0.024642628002432075, 0.02528477396772731, 0.026085154926760824, 0.026701939377919225, 0.027225095836704825, 0.027731620255478942, 0.02824733339048156, 0.028762955999735062, 0.029271689680214975, 0.02974109026797371, 0.0301360380713297, 0.030478744731176118, 0.030793105185076206, 0.03109952161845395, 0.03143076742223823, 0.03181931010075292, 0.03224231827522752, 0.032664489906149244, 0.03315312686992857, 0.03372913313203759, 0.034213341975821515, 0.03466577169332086, 0.03513605520759988, 0.0356455116502536, 0.03615338369011613, 0.03662372562051686, 0.037093226446298325, 0.037564119521184484, 0.03801135580105009, 0.03843333708110238, 0.03883399064195827, 0.03921646179324576, 0.03958329064226569, 0.0399361022364217, 0.0399361022364217, 0.0399361022364217, 0.0399361022364217, 0.0399361022364217, 0.0399361022364217, 0.0399361022364217, 0.0399361022364217},
.param_8 = {1.2989481781905422e-05, 1.3228159644938283e-05, 1.3466837507971134e-05, 1.3705515371003996e-05, 1.3944193234036849e-05, 1.4182871097069706e-05, 1.4421548960102571e-05, 1.4660226823135422e-05, 1.4898904686168283e-05, 1.5137582549201136e-05, 1.5376260412233996e-05, 1.5614938275266852e-05, 1.5853616138299708e-05, 1.6192424334704524e-05, 1.6633887636748878e-05, 1.707535093879325e-05, 1.7516814240837623e-05, 1.7958277542881977e-05, 1.839974084492635e-05, 1.8841204146970705e-05, 1.928266744901508e-05, 1.9724130751059434e-05, 2.0165594053103805e-05, 2.0607057355148183e-05, 2.104852065719254e-05, 2.1489983959236908e-05, 2.1931447261281282e-05, 2.237291056332564e-05, 2.2814373865370007e-05, 2.3255837167414364e-05, 2.3697300469458742e-05, 2.438261836213195e-05, 2.5431938106408108e-05, 2.6481257850684258e-05, 2.7530577594960378e-05, 2.8579897339236532e-05, 2.9629217083512648e-05, 3.0678536827788806e-05, 3.172785657206492e-05, 3.506691280009444e-05, 3.9016970896105436e-05, 4.505985893916376e-05, 5.000292862186422e-05, 5.364382352728194e-05, 5.733992402843847e-05, 6.112708686053665e-05, 6.522020788029813e-05, 7.014729132727326e-05, 7.547388918706927e-05, 8.105062991291749e-05, 8.67520074698191e-05, 9.263758855330882e-05, 9.877407801557254e-05, 0.00010533075585333727, 0.00011268356405935167, 0.00012126819207425817, 0.00013123579628249944, 0.0001420091300576434, 0.00015344854128570786, 0.00016742443647734757, 0.0002101904691245643, 0.00030493146221480195, 0.0003412650388175894, 0.00037508762373909794, 0.00041175877773424926, 0.00044086200523043423, 0.00047610834784765426, 0.0005141330212281752, 0.0005504453956589655, 0.0005836278588520293, 0.0006227031281465219, 0.0006559032901600149, 0.0006923397466875594, 0.0007252868149768926, 0.0007575538594306623, 0.00078988780751385, 0.000826944327284144, 0.0008588522419386135, 0.0008913411513808078, 0.0009234362680854738, 0.0009566340990032224, 0.0009857051200972832, 0.0010113909587090926, 0.001043406197070433, 0.0010680775751167693, 0.0010890038334681932, 0.001109264810219158, 0.0011298933356192627, 0.0011505182399894026, 0.0011708675872085992, 0.0011896436107189487, 0.0012054415228531883, 0.001219149789247045, 0.0012317242074030483, 0.0012439808647381582, 0.0012572306968895294, 0.0012727724040301172, 0.0012896927310091012, 0.0013065795962459701, 0.0013261250747971431, 0.0013491653252815038, 0.0013685336790328607, 0.0013866308677328344, 0.0014054422083039954, 0.0014258204660101443, 0.0014461353476046452, 0.0014649490248206747, 0.0014837290578519334, 0.0015025647808473797, 0.0015204542320420037, 0.0015373334832440957, 0.001553359625678331, 0.0015686584717298309, 0.001583331625690628, 0.0015974440894568685, 0.0015974440894568685, 0.0015974440894568685, 0.0015974440894568685, 0.0015974440894568685, 0.0015974440894568685, 0.0015974440894568685, 0.0015974440894568685},
.param_9 = {1.4290269653020227},
.param_10 = {26.88096707375469, 2.653339696896445},
.param_11 = {0.5143583976566883, 0.013947249693586983},
.param_12 = {0.37422055555861733},
.name = {'L', 'D', '4', '0', '3', '5', '3', '3'},

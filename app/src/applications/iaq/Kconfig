## app/src/applications/iaq/Kconfig
```kconfig
# Copyright (c) 2025 ZSWatch Project
# SPDX-License-Identifier: Apache-2.0

menu "IAQ-App"
    config APPLICATIONS_USE_IAQ
        bool
        prompt "Activate the application 'IAQ'"
        depends on EXTERNAL_USE_BOSCH_BSEC && LV_Z_USE_FILESYSTEM
        default n

    module = IAQ_APP
    module-str = IAQ_APP
    source "subsys/logging/Kconfig.template.log_config"
endmenu
```

## app/src/applications/notification/Kconfig
```kconfig
# Copyright (c) 2025 ZSWatch Project
# SPDX-License-Identifier: Apache-2.0

module = NOTIFICATION_APP
module-str = NOTIFICATION_APP
source "subsys/logging/Kconfig.template.log_config"
```

## app/src/applications/ppt_remote/Kconfig
```kconfig
# Copyright (c) 2025 ZSWatch Project
# SPDX-License-Identifier: Apache-2.0

menu "PPT Remote Application"
    config APPLICATIONS_USE_PPT_REMOTE
        bool
    	prompt "Activate the application 'PPT remote'"
    	default n

    module = ZSW_REMOTE_APP
    module-str = ZSW_REMOTE_APP
    source "subsys/logging/Kconfig.template.log_config"
endmenu
```

## app/src/applications/sensors_summary/Kconfig
```kconfig
# ZSWatch board configuration

# Copyright (c) 2025 ZSWatch Project
# SPDX-License-Identifier: Apache-2.0

menu "Sensor Summary Application"
    config APPLICATIONS_USE_SENSORS_SUMMARY
        bool
    prompt "Activate the application 'Sensors Summary'"
    default y

    menu "Configuration"
        menu "Sensors Summary"
            depends on APPLICATIONS_USE_SENSORS_SUMMARY

            config APPLICATIONS_CONFIGURATION_SENSORS_SUMMARY_REFRESH_INTERVAL_MS
                int
            prompt "Refresh interval in milliseconds"
            default 100
        endmenu
    endmenu
endmenu
```

## app/src/applications/settings/Kconfig
```kconfig
# Copyright (c) 2025 ZSWatch Project
# SPDX-License-Identifier: Apache-2.0

module = ZSW_SETTINGS_APP
module-str = ZSW_SETTINGS_APP
source "subsys/logging/Kconfig.template.log_config"
```

## app/src/applications/speedometer/Kconfig
```kconfig
module = ZSW_SPEEDOMETER_APP
module-str = ZSW_SPEEDOMETER_APP
source "subsys/logging/Kconfig.template.log_config"
```

## app/src/applications/template/Kconfig
```kconfig
module = ZSW_TEMPLATE_APP
module-str = ZSW_TEMPLATE_APP
source "subsys/logging/Kconfig.template.log_config"
```

## app/src/applications/trivia/Kconfig
```kconfig
# Copyright (c) 2025 ZSWatch Project
# SPDX-License-Identifier: Apache-2.0

menu "Trivia-App"
    config APPLICATIONS_USE_TRIVIA
        bool
    prompt "Activate the application 'Trivia'"
    default y

    module = ZSW_TRIVIA_APP
    module-str = ZSW_TRIVIA_APP
    source "subsys/logging/Kconfig.template.log_config"
endmenu
```

## app/src/applications/voice_memo/Kconfig
```kconfig
# Copyright (c) 2025 ZSWatch Project
# SPDX-License-Identifier: Apache-2.0

menu "Voice Memo"

config APPLICATIONS_USE_VOICE_MEMO
    bool
    prompt "Activate the application 'Voice Memo'"
    default y
    depends on ZSW_MIC && ZSW_OPUS_CODEC

endmenu

module = ZSW_VOICE_MEMO
module-str = ZSW_VOICE_MEMO
source "subsys/logging/Kconfig.template.log_config"
```

## app/src/basic_battery/Kconfig
```kconfig
# Copyright (c) 2025 ZSWatch Project
# SPDX-License-Identifier: Apache-2.0

module = ZSW_BATTERY
module-str = ZSW_BATTERY
source "subsys/logging/Kconfig.template.log_config"
```

## app/src/ble/Kconfig
```kconfig
# ZSWatch board configuration

# Copyright (c) 2025 ZSWatch Project
# SPDX-License-Identifier: Apache-2.0

menu "BLE"
    config BLE_DISABLE_PAIRING_REQUIRED
        bool
        prompt "Disable encryption required for BLE connection (pairing/bonding)"
        default n
        help
            Disable encryption for BLE connection (pairing/bonding). Used only for debugging purposes.

    module = ZSW_BLE
    module-str = ZSW_BLE
    source "subsys/logging/Kconfig.template.log_config"
endmenu
```

## app/src/codec/Kconfig
```kconfig
# Copyright (c) 2025 ZSWatch Project
# SPDX-License-Identifier: Apache-2.0

menu "Audio Codec"

    config ZSW_OPUS_CODEC
        bool "Enable Opus audio codec"
        default y if ZSW_MIC
        help
          Integrates the Opus audio codec library (fixed-point mode).
          Enables compressed audio recording and future BLE streaming.

    config ZSW_OPUS_BITRATE
        int "Opus encoder bitrate (bps)"
        default 32000
        depends on ZSW_OPUS_CODEC
        help
          Target bitrate for the Opus encoder in bits per second.
          32000 (32 kbps) gives ~8x compression vs raw 16-bit 16kHz PCM.

    config ZSW_OPUS_COMPLEXITY
        int "Opus encoder complexity (0-10)"
        default 3
        depends on ZSW_OPUS_CODEC
        range 0 10
        help
          Opus encoder complexity. Higher values produce better quality
          at the cost of more CPU usage. 3 is a good balance for nRF5340.

    config ZSW_OPUS_FRAME_SIZE_SAMPLES
        int "Opus frame size in samples"
        default 160
        depends on ZSW_OPUS_CODEC
        help
          Number of PCM samples per Opus frame. 160 = 10ms at 16kHz.
          Smaller frames = lower latency but slightly less compression.

    module = ZSW_AUDIO_CODEC
    module-str = ZSW_AUDIO_CODEC
    source "subsys/logging/Kconfig.template.log_config"

endmenu
```

## app/src/fuel_gauge/Kconfig
```kconfig
config ZSW_PMIC_BATTERY_CUTOFF_VOLTAGE_MV
	int "The voltage at which the system will be powered off. Running batteries as low as possible (until battery protection circuit triggers) will reduce the battery life."
	depends on DT_HAS_NORDIC_NPM1300_ENABLED
	default 3300
	help
	  Voltage in mV at which the system will be powered off.
```

## app/src/history/Kconfig
```kconfig
# Copyright (c) 2025 ZSWatch Project
# SPDX-License-Identifier: Apache-2.0

module = ZSW_HISTORY
module-str = ZSW_HISTORY
source "subsys/logging/Kconfig.template.log_config"
```

## app/src/llext/Kconfig
```kconfig
# Copyright (c) 2026 ZSWatch Project
# SPDX-License-Identifier: Apache-2.0

if ZSW_LLEXT_APPS

    menu "LLEXT App Manager"
        module = ZSW_LLEXT_APP_MANAGER
        module-str = ZSW_LLEXT_APP_MANAGER
        source "subsys/logging/Kconfig.template.log_config"
    endmenu

    menu "LLEXT XIP"
        module = ZSW_LLEXT_XIP
        module-str = ZSW_LLEXT_XIP
        source "subsys/logging/Kconfig.template.log_config"
    endmenu

endif # ZSW_LLEXT_APPS
```

## app/src/sensor_fusion/Kconfig
```kconfig
# Copyright (c) 2025 ZSWatch Project, Leonardo Bispo, Jakob Krantz
# SPDX-License-Identifier: Apache-2.0

module = ZSW_SENSORS_FUSION
module-str = ZSW_SENSORS_FUSION
source "subsys/logging/Kconfig.template.log_config"
```

## app/src/sensors/Kconfig
```kconfig
# Copyright (c) 2025 ZSWatch Project
# SPDX-License-Identifier: Apache-2.0

menu "Sensors"
    module = ZSW_SENSORS
    module-str = ZSW_SENSORS
    source "subsys/logging/Kconfig.template.log_config"
endmenu
```

## app/src/sensors/sensor_fusion/Kconfig
```kconfig
# Copyright (c) 2025 ZSWatch Project, Leonardo Bispo, Jakob Krantz
# SPDX-License-Identifier: Apache-2.0

menu "Sensor Fusion"
    config SENSOR_FUSION_INCLUDE_MAGNETOMETER
        bool
    prompt "Include Magnetometer reading in sensor fusion algorithm"
    default y
    help
        "If the magnetometer is not well calibrated, you must disable this option."

    config SEND_SENSOR_READING_OVER_RTT
        bool
    prompt "Log sensor fusion reading to RTT"
    default 1
    help
        Python script can be used to read, analyze the RTT channel and plot the sensor fusion reading.

    if SEND_SENSOR_READING_OVER_RTT
        config SENSOR_LOG_RTT_TRANSFER_CHANNEL
            int
        prompt "The RTT channel to use for transfer of sensor fusion reading"
        default 1
        help
            If RTT logging is enabled.
    endif

    module = ZSW_SENSORS_FUSION
    module-str = ZSW_SENSORS_FUSION
    source "subsys/logging/Kconfig.template.log_config"
endmenu
```

## app/src/ui/utils/Kconfig
```kconfig
# Copyright (c) 2025 ZSWatch Project
# SPDX-License-Identifier: Apache-2.0

menu "UI"
    config STORE_IMAGES_EXTERNAL_FLASH
        bool "Store UI Images into the External Flash"
endmenu
```

## app/sysbuild/mcuboot/boards/nrf5340dk_nrf5340_cpuapp.conf
```kconfig
# MCUBoot serial recovery
CONFIG_MCUBOOT_SERIAL=y
CONFIG_BOOT_SERIAL_CDC_ACM=y
CONFIG_UART_CONSOLE=n
```

## app/sysbuild/mcuboot/boards/watchdk_nrf5340_cpuapp.conf
```kconfig
# Copyright (c) 2025 ZSWatch Project
# SPDX-License-Identifier: Apache-2.0

# MCUBoot serial recovery
CONFIG_MCUBOOT_SERIAL=y
CONFIG_BOOT_SERIAL_CDC_ACM=y

# Logs over UART
CONFIG_SERIAL=n
CONFIG_CONSOLE=n
CONFIG_UART_CONSOLE=n
```

## app/sysbuild/mcuboot/boards/watchdk_nrf5340_cpuapp_1.conf
```kconfig
CONFIG_PWM=n

CONFIG_SPI=n

CONFIG_I2C=n

CONFIG_SENSOR=n

CONFIG_RTC=n

CONFIG_NRF_FUEL_GAUGE=n

CONFIG_APDS9306=n

CONFIG_LIS2MDL=n

CONFIG_DISPLAY=n

CONFIG_INPUT=n

CONFIG_REGULATOR=n
CONFIG_REGULATOR_FIXED=n

CONFIG_RETENTION=n
CONFIG_RETAINED_MEM=n

CONFIG_NVS=n

CONFIG_COUNTER=n

CONFIG_NRFX_TIMER1=n

CONFIG_NRF_FUEL_GAUGE=n

CONFIG_NORDIC_QSPI_NOR_XIP=n
CONFIG_NORDIC_QSPI_NOR_STACK_WRITE_BUFFER_SIZE=16

# The network core cannot access external flash directly. The flash simulator must be used to
# provide a memory region that is used to forward the new firmware to the network core.
CONFIG_FLASH_SIMULATOR=y
CONFIG_FLASH_SIMULATOR_DOUBLE_WRITES=y
CONFIG_FLASH_SIMULATOR_STATS=n
CONFIG_STREAM_FLASH=n
CONFIG_FLASH_MAP=n
CONFIG_FLASH_MAP_LABELS=n

CONFIG_PM=n
CONFIG_PM_DEVICE=n
```

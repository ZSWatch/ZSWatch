## app/src/applications/chat/Kconfig
```kconfig
# Copyright (c) 2026 ZSWatch Project
# SPDX-License-Identifier: Apache-2.0

menu "Chat"

config APPLICATIONS_USE_CHAT
    bool
    prompt "Activate the application 'Chat'"
    default y
    depends on APPLICATIONS_USE_VOICE_MEMO

module = ZSW_CHAT_APP
module-str = ZSW_CHAT_APP
source "subsys/logging/Kconfig.template.log_config"

endmenu
```

## app/src/applications/compass/Kconfig
```kconfig
# ZSWatch board configuration

# Copyright (c) 2025 ZSWatch Project
# SPDX-License-Identifier: Apache-2.0

menu "Compass Application"
    config APPLICATIONS_USE_COMPASS
        bool
    prompt "Activate the application 'Compass'"
    default y

    menu "Configuration"
        menu "Compass"
            depends on APPLICATIONS_USE_COMPASS

            config APPLICATIONS_CONFIGURATION_COMPASS_REFRESH_INTERVAL_MS
                int
                prompt "Refresh interval in milliseconds"
                default 50

            config APPLICATIONS_CONFIGURATION_COMPASS_CALIBRATION_TIME_S
                int
                prompt "Calibration time in seconds"
                default 30
        endmenu
    endmenu
endmenu
```

## app/src/applications/lea_assistant/Kconfig
```kconfig
config ZSW_LEA_ASSISTANT_FAKE_SOURCE_DISCOVERY
		bool "Add a demo LE Audio source during source scan"
		depends on APPLICATIONS_USE_LEA_ASSISTANT
		default n
		help
			Adds a fake broadcast source to the LE Audio Assistant source list so the
			conference demo can exercise the full UI without source hardware.

module = ZSW_LEA_ASSISTANT_APP
module-str = ZSW_LEA_ASSISTANT_APP
source "subsys/logging/Kconfig.template.log_config"
```

## app/src/applications/tiles/Kconfig
```kconfig
# Copyright (c) 2026 ZSWatch Project
# SPDX-License-Identifier: Apache-2.0

menu "Tiles"

config APPLICATIONS_USE_TILES
    bool
    prompt "Activate the application 'Tiles', glance cards shown by swiping right on the watchface"
    default y

module = ZSW_TILES_APP
module-str = ZSW_TILES_APP
source "subsys/logging/Kconfig.template.log_config"

endmenu
```

## app/src/applications/watchface/Kconfig
```kconfig
# ZSWatch board configuration

# Copyright (c) 2025 ZSWatch Project
# SPDX-License-Identifier: Apache-2.0

menu "Watchface"
    config WATCHFACE_DIGITAL
        bool
        prompt "Add digital watchface"
        default y

    config WATCHFACE_DIGITAL_MINIMAL
        bool
        prompt "Add digital minimal watchface"
        default y

    config WATCHFACE_MINIMAL
        bool
        prompt "Add minimal watchface"
        default y

    config WATCHFACE_LIVING_SKY
        bool
        prompt "Add Living Sky watchface (animated weather and sky tint)"
        default y

    config WATCHFACE_SNOW
        bool
        prompt "Add Snow watchface (digits of snow that fall the way the watch is held)"
        default y

    config WATCHFACE_DIORAMA
        bool
        prompt "Add Diorama watchface (a landscape with depth that follows the sun and the weather)"
        default y

endmenu
```

## app/src/managers/Kconfig
```kconfig
# Copyright (c) 2025 ZSWatch Project
# SPDX-License-Identifier: Apache-2.0

menu "Managers"
    config ZSW_HR_MANAGER
        bool "Manage background heart-rate acquisition"
        default y
        depends on DT_HAS_MAXIM_MAX32664C_ENABLED && SETTINGS
        help
          Decides when the heart rate sensor runs: periodic background measurements,
          continuous measurement while moving, or manual one-shot measurements.

    if ZSW_HR_MANAGER
    config ZSW_HR_BACKGROUND_INTERVAL_SECONDS
        int "Background HR interval (seconds)"
        default 300
        range 30 3600
        help
          Time between the start of two background measurements, in background mode.
          Measurements only start while the watch is moving (worn). Each measurement
          runs the optical sensor, about 1.2 mA extra, until a heart rate is accepted
          (typically 10-20 s) or ZSW_HR_ATTEMPT_TIMEOUT_SECONDS. With the default 300 s,
          a 15 s measurement adds about 60 uA on average; halving the interval doubles it.

    config ZSW_HR_ATTEMPT_TIMEOUT_SECONDS
        int "Maximum one-shot HR attempt (seconds)"
        default 45
        range 5 120
        help
          Longest time a background or manual measurement keeps the optical sensor on
          without getting an accepted heart rate. Also how long continuous mode waits
          for a sensor report before restarting the sensor. Bounds the worst case power
          use of a failing measurement, for example with a loose fit.

    config ZSW_HR_MIN_CONFIDENCE
        int "Minimum accepted HR confidence"
        default 75
        range 1 100
        help
          Minimum confidence (percent) reported by the sensor hub for a heart rate to be
          accepted and published.

    config ZSW_HR_GOOD_REPORTS
        int "Consecutive good reports before accepting HR"
        default 3
        range 1 10
        help
          Number of consecutive reports (one per second) with skin contact and at least
          ZSW_HR_MIN_CONFIDENCE before a heart rate is accepted. Higher values reject
          more noise but keep the sensor on longer per measurement.
    endif

    menu "Power Manager"
        module = ZSW_PWR_MANAGER
        module-str = ZSW_PWR_MANAGER
        source "subsys/logging/Kconfig.template.log_config"
    endmenu

    menu "XIP Manager"
        depends on ZSW_XIP

        module = ZSW_XIP_MANAGER
        module-str = ZSW_XIP_MANAGER
        source "subsys/logging/Kconfig.template.log_config"
    endmenu

    menu "Mic Manager"
        config ZSW_MIC
            bool
            prompt "Enable Mic functionality"
            select AUDIO
            select AUDIO_DMIC
            default n

        config ZSW_MIC_DEFAULT_GAIN
            int "Default PDM microphone gain (0-80)"
            default 40
            range 0 80
            depends on ZSW_MIC
            help
                PDM gain register value applied at mic init.
                0 = mute (-20 dB), 40 = 0 dB (default), 80 = +20 dB.
                Can be changed at runtime via zsw_microphone_set_gain()
                or the 'mic gain_set' shell command.

        module = ZSW_MIC_MANAGER
        module-str = ZSW_MIC_MANAGER
        source "subsys/logging/Kconfig.template.log_config"
    endmenu
endmenu
```

## app/src/ui/Kconfig
```kconfig
# Copyright (c) 2025 ZSWatch Project, Leonardo Bispo, Jakob Krantz
# SPDX-License-Identifier: Apache-2.0

menu "UI"
    menu "UI Controller"
        module = ZSW_UI_CONTROLLER
        module-str = ZSW_UI_CONTROLLER
        source "subsys/logging/Kconfig.template.log_config"
    endmenu

    config ZSW_NOTIFICATION_REPLY
        bool "Reply to notifications by voice"
        default y
        depends on APPLICATIONS_USE_VOICE_MEMO
        help
          Shows a Reply button on notifications the phone can answer. The reply is
          recorded on the watch, transcribed by the phone and shown for review before
          the phone sends it.

    module = ZSW_NOTIFICATION_REPLY
    module-str = ZSW_NOTIFICATION_REPLY
    source "subsys/logging/Kconfig.template.log_config"

    rsource "utils/Kconfig"
endmenu
```

## app/boards/watchdk_nrf5340_cpuapp_1.conf
```kconfig
# Flash
CONFIG_FLASH=y
CONFIG_FLASH_PAGE_LAYOUT=y
CONFIG_STREAM_FLASH=y
CONFIG_FLASH_MAP=y
CONFIG_NORDIC_QSPI_NOR=y
CONFIG_NORDIC_QSPI_NOR_FLASH_LAYOUT_PAGE_SIZE=4096
CONFIG_NORDIC_QSPI_NOR_INIT_PRIORITY=1
CONFIG_SPI_FLASH_LOADER=y

CONFIG_MPU_ALLOW_FLASH_WRITE=y

CONFIG_FILE_SYSTEM=y
CONFIG_FILE_SYSTEM_LITTLEFS=y
CONFIG_LV_Z_USE_FILESYSTEM=y
CONFIG_LV_IMG_CACHE_DEF_SIZE=10

CONFIG_FS_LITTLEFS_FC_HEAP_SIZE=16384
CONFIG_FS_LITTLEFS_NUM_FILES=64

# APDS9306
CONFIG_APDS9306=y
CONFIG_APDS9306_IS_APDS9306_065=y

# NCS External flash
# The sizes here need to match dts
CONFIG_PM_OVERRIDE_EXTERNAL_DRIVER_CHECK=y
CONFIG_PM_PARTITION_REGION_SETTINGS_STORAGE_EXTERNAL=y
CONFIG_PM_PARTITION_SIZE_SETTINGS_STORAGE=0x100000

CONFIG_PM_PARTITION_REGION_LITTLEFS_EXTERNAL=y
CONFIG_PM_PARTITION_SIZE_LITTLEFS=0x200000

CONFIG_NRF_FUEL_GAUGE=y
CONFIG_MFD_NPM1300_INIT_PRIORITY=51
CONFIG_REGULATOR_NPM1300_COMMON_INIT_PRIORITY=52
CONFIG_REGULATOR_NPM1300_INIT_PRIORITY=53

CONFIG_SETTINGS_NVS=y
CONFIG_NVS=y

CONFIG_DEBUG_COREDUMP_BACKEND_OTHER=y

CONFIG_RTC=y
CONFIG_RTC_UPDATE=n
CONFIG_RTC_ALARM=y

CONFIG_STORE_IMAGES_EXTERNAL_FLASH=y

# Enable USB subsystem
CONFIG_USB_DEVICE_STACK=y
CONFIG_UART_LINE_CTRL=y
CONFIG_USB_DEVICE_INITIALIZE_AT_BOOT=n

# FOTA 
CONFIG_NCS_SAMPLE_MCUMGR_BT_OTA_DFU=y

CONFIG_BT_GATT_DYNAMIC_DB=y
CONFIG_MCUMGR_TRANSPORT_BT_DYNAMIC_SVC_REGISTRATION=y
CONFIG_MCUMGR_MGMT_NOTIFICATION_HOOKS=y
CONFIG_MCUMGR_GRP_IMG_UPLOAD_CHECK_HOOK=y
CONFIG_MCUMGR_GRP_IMG_IMAGE_SLOT_STATE_HOOK=y
CONFIG_MCUMGR_GRP_IMG_STATUS_HOOKS=y

# Enable MCUMGR management for both OS and Images
CONFIG_MCUMGR_GRP_OS=y
CONFIG_MCUMGR_GRP_OS_TASKSTAT=y
CONFIG_MCUMGR_GRP_IMG=y

CONFIG_MCUMGR_GRP_FS=y
CONFIG_MCUMGR_GRP_FS_LOG_LEVEL_DBG=y

# Dependencies
# Configure dependencies for CONFIG_MCUMGR  
CONFIG_NET_BUF=y
CONFIG_ZCBOR=y
CONFIG_CRC=y

# Configure dependencies for CONFIG_MCUMGR_GRP_IMG  
CONFIG_FLASH=y
CONFIG_IMG_MANAGER=y

# Configure dependencies for CONFIG_IMG_MANAGER  
CONFIG_STREAM_FLASH=y
CONFIG_FLASH_MAP=y

# Configure dependencies for CONFIG_MCUMGR_TRANSPORT_UART 
CONFIG_BASE64=y

# TODO: Clean up
#CONFIG_MCUMGR=y
#CONFIG_MCUMGR_GRP_SHELL=y
#CONFIG_MCUMGR_TRANSPORT_UART=y
#CONFIG_MCUMGR_TRANSPORT_WORKQUEUE_STACK_SIZE=8096
#CONFIG_SHELL=y
#CONFIG_SHELL_STACK_SIZE=4096
#CONFIG_SHELL_BACKEND_SERIAL=y
#CONFIG_MCUMGR_TRANSPORT_SHELL=y

# mcumgr-cli application doesn't accepts log in the channel it uses
#CONFIG_SHELL_LOG_BACKEND=n

#CONFIG_CONSOLE=y
#CONFIG_UART_CONSOLE=y
#CONFIG_UART_CONSOLE_MCUMGR=y
#CONFIG_SHELL_BACKEND_DUMMY=y

# XIP
CONFIG_HAVE_CUSTOM_LINKER_SCRIPT=y
CONFIG_CODE_DATA_RELOCATION=y
CONFIG_BUILD_NO_GAP_FILL=y
CONFIG_CUSTOM_LINKER_SCRIPT="linker_arm_extxip.ld"
CONFIG_FLASH_INIT_PRIORITY=40
CONFIG_NORDIC_QSPI_NOR_XIP=y
```

## app/boards/zswatch/watchdk/Kconfig
```kconfig
# ZSWatch Development Kit board configuration

# Copyright (c) 2025 ZSWatch Project
# SPDX-License-Identifier: Apache-2.0

if BOARD_WATCHDK_NRF5340_CPUAPP || BOARD_WATCHDK_NRF5340_CPUAPP_NS

config DOMAIN_CPUNET_BOARD
    string
    default "watchdk/nrf5340/cpunet"
    depends on BOARD_ENABLE_CPUNET
    help
      The board which will be used for CPUNET domain when creating a multi
      image application where one or more images should be located on
      another board. For example hci_ipc on the nRF5340_cpunet for
      Bluetooth applications.

endif

config DOMAIN_CPUAPP_BOARD
    string
    default "watchdk/nrf5340/cpuapp"
    depends on BOARD_WATCHDK_NRF5340_CPUNET
    help
      The board which will be used for CPUAPP domain when creating a multi
      image application where one or more images should be located on
      another board.
```

## app/boards/zswatch/watchdk/Kconfig.watchdk
```kconfig
# ZSWatch Development Kit board configuration

# Copyright (c) 2025 ZSWatch Project
# SPDX-License-Identifier: Apache-2.0

config BOARD_WATCHDK
    select SOC_NRF5340_CPUAPP_QKAA if BOARD_WATCHDK_NRF5340_CPUAPP
    select SOC_NRF5340_CPUAPP_QKAA if BOARD_WATCHDK_NRF5340_CPUAPP_NS
    select SOC_NRF5340_CPUNET_QKAA if BOARD_WATCHDK_NRF5340_CPUNET
```

## app/boards/zswatch/watchdk/board.yml
```yaml
# Copyright (c) 2025 ZSWatch Project
# SPDX-License-Identifier: Apache-2.0

board:
  name: watchdk
  full_name: ZSWatch Watch DevKit
  vendor: zswatch
  socs:
  - name: 'nrf5340'
    variants:
    - name: 'ns'
      cpucluster: 'cpuapp'
  revision:
    format: number
    default: "1"
    exact: false
    revisions:
    - name: "1"
```

## app/boards/zswatch/watchdk/watchdk_nrf5340_cpuapp_1_defconfig
```kconfig
CONFIG_MAIN_STACK_SIZE=2048
CONFIG_HEAP_MEM_POOL_SIZE=25000

CONFIG_SENSOR=y

CONFIG_PM=y
CONFIG_PM_DEVICE=y
CONFIG_PM_DEVICE_RUNTIME=y

CONFIG_DISPLAY=y

CONFIG_INPUT=y

CONFIG_REGULATOR=y
CONFIG_REGULATOR_FIXED=y

CONFIG_NVS=y

CONFIG_RETAINED_MEM=y
CONFIG_RETENTION=y
CONFIG_RETENTION_BOOT_MODE=y
CONFIG_RETENTION_MUTEX_FORCE_DISABLE=y
CONFIG_RETAINED_MEM_MUTEX_FORCE_DISABLE=y
CONFIG_RETENTION_BUFFER_SIZE=256

# Flash
CONFIG_FLASH=y
CONFIG_FLASH_PAGE_LAYOUT=y
CONFIG_STREAM_FLASH=y
CONFIG_FLASH_MAP=y
CONFIG_FLASH_MAP_LABELS=y

CONFIG_NRF_FUEL_GAUGE=y
CONFIG_MFD_NPM1300_INIT_PRIORITY=51
CONFIG_REGULATOR_NPM1300_COMMON_INIT_PRIORITY=52
CONFIG_REGULATOR_NPM1300_INIT_PRIORITY=53

# TODO: Clean up
#CONFIG_MCUMGR_GRP_SHELL=y
#CONFIG_MCUMGR_TRANSPORT_UART=y
#CONFIG_MCUMGR_TRANSPORT_WORKQUEUE_STACK_SIZE=8096
#CONFIG_SHELL=y
#CONFIG_SHELL_STACK_SIZE=4096
#CONFIG_SHELL_BACKEND_SERIAL=y
#CONFIG_MCUMGR_TRANSPORT_SHELL=y

# mcumgr-cli application doesn't accepts log in the channel it uses
#CONFIG_SHELL_LOG_BACKEND=n

#CONFIG_CONSOLE=y
#CONFIG_UART_CONSOLE=y
#CONFIG_UART_CONSOLE_MCUMGR=y
#CONFIG_SHELL_BACKEND_DUMMY=y

CONFIG_NORDIC_QSPI_NOR=y
CONFIG_NORDIC_QSPI_NOR_XIP=y
CONFIG_NORDIC_QSPI_NOR_FLASH_LAYOUT_PAGE_SIZE=4096
CONFIG_NORDIC_QSPI_NOR_INIT_PRIORITY=1

# RTC (RV-8263-C8) configuration
CONFIG_RTC=y
CONFIG_RTC_UPDATE=n
CONFIG_RTC_ALARM=y

# APDS9306 (Light sensor) configuration
CONFIG_APDS9306=y

# LIS2MDL (Magnetometer) configuration
CONFIG_LIS2MDL=y
CONFIG_LIS2MDL_MAG_ODR_RUNTIME=y
CONFIG_LIS2MDL_TRIGGER_OWN_THREAD=y

# CST816S (Touch Controller) configuration
CONFIG_INPUT_CST816S_INTERRUPT=y
CONFIG_INPUT_CST816S=n
```

## app/boards/zswatch/watchdk/watchdk_nrf5340_cpuapp_defconfig
```kconfig
# Copyright (c) 2025 ZSWatch Project
# SPDX-License-Identifier: Apache-2.0

# Enable MPU
CONFIG_MPU=y
CONFIG_ARM_MPU=y
CONFIG_MPU_ALLOW_FLASH_WRITE=y

# Enable hardware stack protection
CONFIG_HW_STACK_PROTECTION=y

# Enable TrustZone-M
CONFIG_ARM_TRUSTZONE_M=y

# Enable GPIO
CONFIG_GPIO=y

CONFIG_I2C=y

CONFIG_ADC=n

CONFIG_PINCTRL=y

CONFIG_PWM=y

CONFIG_COUNTER=y
CONFIG_NRFX_TIMER1=y

CONFIG_SPI=y

# Disable UART driver
CONFIG_SERIAL=n

# Disable console
CONFIG_CONSOLE=n
CONFIG_UART_CONSOLE=n

# Enable the reboot API
CONFIG_REBOOT=y

CONFIG_RESET_ON_FATAL_ERROR=y

CONFIG_CLOCK_CONTROL_NRF_K32SRC_RC=y

# Ensure GPIO P0.01 and P0.00 can be used
CONFIG_SOC_ENABLE_LFXO=n

# Change the NCS boot string
CONFIG_NCS_APPLICATION_BOOT_BANNER_STRING="WatchDK"
```

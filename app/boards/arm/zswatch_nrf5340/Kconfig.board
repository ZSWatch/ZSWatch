## app/boards/arm/zswatch_nrf5340/Kconfig.board
```kconfig
# ZSWatch NRF5340 board configuration

# Copyright (c) 2023 Jakob Krantz
# SPDX-License-Identifier: Apache-2.0

if SOC_NRF5340_CPUAPP_QKAA

config BOARD_ZSWATCH_NRF5340_CPUAPP
	bool "ZSWatch nRF5340 Application MCU"

config BOARD_ZSWATCH_NRF5340_CPUAPP_NS
	bool "ZSWatch nRF5340 Application MCU non-secure"

endif # SOC_NRF5340_CPUAPP_QKAA

if SOC_NRF5340_CPUNET_QKAA

config BOARD_ZSWATCH_NRF5340_CPUNET
	bool "ZSWatch nRF5340 Network MCU"

endif # SOC_NRF5340_CPUNET_QKAA
```

## app/boards/arm/zswatch_nrf5340/zswatch_nrf5340_cpuapp_defconfig
```kconfig
# SPDX-License-Identifier: Apache-2.0

CONFIG_SOC_SERIES_NRF53X=y
CONFIG_SOC_NRF5340_CPUAPP_QKAA=y
CONFIG_BOARD_ZSWATCH_NRF5340_CPUAPP=y

# Enable MPU
CONFIG_ARM_MPU=y

# Enable hardware stack protection
CONFIG_HW_STACK_PROTECTION=y

# Enable TrustZone-M
CONFIG_ARM_TRUSTZONE_M=y

# Enable GPIO
CONFIG_GPIO=y

# Enable console
CONFIG_CONSOLE=y
CONFIG_UART_CONSOLE=y

# Enable uart driver
CONFIG_SERIAL=y

CONFIG_PINCTRL=y

CONFIG_CLOCK_CONTROL_NRF_K32SRC_RC=y
# Ensure GPIO P0.01 and P0.00 can be used
CONFIG_SOC_ENABLE_LFXO=n
```

## app/boards/arm/zswatch_nrf5340/zswatch_nrf5340_cpunet_defconfig
```kconfig
# SPDX-License-Identifier: Apache-2.0

CONFIG_SOC_SERIES_NRF53X=y
CONFIG_SOC_NRF5340_CPUNET_QKAA=y
CONFIG_BOARD_ZSWATCH_NRF5340_CPUNET=y

# Enable MPU
CONFIG_ARM_MPU=y

# Enable hardware stack protection
CONFIG_HW_STACK_PROTECTION=y

# Enable GPIO
CONFIG_GPIO=y

CONFIG_PINCTRL=y
CONFIG_BT=y
CONFIG_BT_CTLR_DF=y
CONFIG_BT_CTLR_ADV_EXT=y
CONFIG_BT_CTLR_ADV_PERIODIC=y
CONFIG_BT_CTLR_ADVANCED_FEATURES=y
CONFIG_BT_CTLR_ADV_SYNC_PDU_BACK2BACK=y
CONFIG_BT_CTLR_DF_PER_ADV_CTE_NUM_MAX=1
```

## app/boards/da7212_test.conf
```kconfig
# Copyright (c) 2025 ZSWatch Project
# SPDX-License-Identifier: Apache-2.0

# DA7212 Audio Codec Test configuration

CONFIG_I2S=y
CONFIG_AUDIO=y
CONFIG_AUDIO_CODEC=y
CONFIG_CLOCK_CONTROL_FIXED_RATE_CLOCK=y

# Allow MCK bypass: MCK = HFCLKAUDIO = 12.288 MHz = 256 * 48 kHz
CONFIG_I2S_NRFX_ALLOW_MCK_BYPASS=y

# Enable the DA7212 test app
CONFIG_APPLICATIONS_USE_DA7212_TEST=y
```

## app/boards/debug.conf
```kconfig
# Copyright (c) 2025 ZSWatch Project
# SPDX-License-Identifier: Apache-2.0

CONFIG_BLE_DISABLE_PAIRING_REQUIRED=y
CONFIG_SENSOR_LOG_LEVEL_WRN=y
CONFIG_THREAD_NAME=y
CONFIG_PRINTK=y

# SEGGER RTT logging instead of UART
CONFIG_LOG_PRINTK=y
CONFIG_LOG=y
CONFIG_LOG_BUFFER_SIZE=4096
CONFIG_LOG_INFO_COLOR_GREEN=y
CONFIG_LOG_DEFAULT_LEVEL=2
CONFIG_LOG_RUNTIME_FILTERING=n
# End of SEGGER RTT

# CONFIG_DEBUG_OPTIMIZATIONS OPTIMIZATIONS adds over 100kB to the binary size.
# If you need to debug, enable this and disable some other features to fit it in flash.
# CONFIG_DEBUG_OPTIMIZATIONS=y

# Comment out to show FPS counter
#CONFIG_LV_USE_SYSMON=y
#CONFIG_LV_USE_PERF_MONITOR=y
#CONFIG_LV_PERF_MONITOR_ALIGN_RIGHT_MID=y

CONFIG_ZSW_SENSORS_LOG_LEVEL_WRN=y
CONFIG_ZSW_BLE_LOG_LEVEL_INF=y
CONFIG_ZSW_SETTINGS_APP_LOG_LEVEL_WRN=y
CONFIG_ZSW_APP_LOG_LEVEL_DBG=y
CONFIG_MISC_ENABLE_SYSTEM_RESET=y

CONFIG_LV_USE_LOG=y
CONFIG_LV_LOG_LEVEL_WARN=y
```

## app/boards/dfu.conf
```kconfig
#---------------
# FLASH
#-----------------
CONFIG_FLASH=y
CONFIG_FLASH_PAGE_LAYOUT=y
CONFIG_STREAM_FLASH=y
CONFIG_FLASH_MAP=y
CONFIG_NVS=y
CONFIG_SPI_NOR=y
CONFIG_SPI_NOR_SFDP_RUNTIME=y
# -----------
# BOOTLOADER
# ------------
CONFIG_BOOTLOADER_MCUBOOT=y
CONFIG_MCUMGR=y
CONFIG_ZCBOR=y
CONFIG_IMG_MANAGER=y
CONFIG_MCUMGR_GRP_IMG=y
CONFIG_MCUMGR_GRP_OS=y
CONFIG_MCUMGR_MGMT_NOTIFICATION_HOOKS=y
CONFIG_MCUMGR_GRP_IMG_STATUS_HOOKS=y
CONFIG_MCUMGR_GRP_IMG_UPLOAD_CHECK_HOOK=y
CONFIG_MCUBOOT_GENERATE_UNSIGNED_IMAGE=y
CONFIG_MCUBOOT_GENERATE_CONFIRMED_IMAGE=n
# SMP
CONFIG_MCUMGR_TRANSPORT_BT=y
CONFIG_MCUMGR_TRANSPORT_BT_AUTHEN=n 
# Enable the mcumgr Packet Reassembly feature over Bluetooth and its configuration dependencies.
# MCUmgr buffer size is optimized to fit one SMP packet divided into five Bluetooth Write Commands,
# transmitted with the maximum possible MTU value: 498 bytes.
CONFIG_MCUMGR_TRANSPORT_BT_REASSEMBLY=y
CONFIG_MCUMGR_TRANSPORT_NETBUF_SIZE=2475
# Enable the storage erase command.
CONFIG_MCUMGR_GRP_ZBASIC=y
CONFIG_MCUMGR_GRP_ZBASIC_STORAGE_ERASE=y
# DFU over BT requires 
# increase of ble throughput
CONFIG_BT_L2CAP_TX_MTU=498
CONFIG_BT_BUF_ACL_RX_SIZE=502
CONFIG_BT_BUF_ACL_TX_SIZE=502

# Allow mcumgr to increase conn. parameters
# for a faster image transfer
CONFIG_MCUMGR_TRANSPORT_BT_CONN_PARAM_CONTROL=y
# Default settings for slower comm.
CONFIG_BT_PERIPHERAL_PREF_MIN_INT=400
CONFIG_BT_PERIPHERAL_PREF_MAX_INT=500
CONFIG_BT_PERIPHERAL_PREF_LATENCY=0
CONFIG_BT_PERIPHERAL_PREF_TIMEOUT=1000
```

## app/boards/jakkra/zswatch/Kconfig
```kconfig
# nRF5340 DK board configuration

# Copyright (c) 2019 - 2021 Nordic Semiconductor ASA
# SPDX-License-Identifier: Apache-2.0

if BOARD_ZSWATCH_NRF5340_CPUAPP || BOARD_ZSWATCH_NRF5340_CPUAPP_NS

config DOMAIN_CPUNET_BOARD
	string
	default "zswatch/nrf5340/cpunet"
	depends on BOARD_ENABLE_CPUNET
	help
	  The board which will be used for CPUNET domain when creating a multi
	  image application where one or more images should be located on
	  another board. For example hci_ipc on the nRF5340_cpunet for
	  Bluetooth applications.

endif #  BOARD_ZSWATCH_NRF5340_CPUAPP || BOARD_ZSWATCH_NRF5340_CPUAPP_NS

config DOMAIN_CPUAPP_BOARD
	string
	default "zswatch/nrf5340/cpuapp"
	depends on BOARD_ZSWATCH_NRF5340_CPUNET
	help
	  The board which will be used for CPUAPP domain when creating a multi
	  image application where one or more images should be located on
	  another board.
```

## app/boards/jakkra/zswatch/board.yml
```yaml
board:
  name: zswatch
  vendor: nordic
  socs:
  - name: 'nrf5340'
    variants:
    - name: 'ns'
      cpucluster: 'cpuapp'
  revision:
    format: number
    default: "5"
    exact: false
    revisions:
    - name: "3"
    - name: "4"
    - name: "5"
```

## app/boards/jakkra/zswatch/zswatch_nrf5340_cpuapp_5_defconfig
```kconfig
# FLASH
CONFIG_FLASH=y
CONFIG_FLASH_PAGE_LAYOUT=y
CONFIG_STREAM_FLASH=y
CONFIG_FLASH_MAP=y
CONFIG_NORDIC_QSPI_NOR=y
CONFIG_NORDIC_QSPI_NOR_FLASH_LAYOUT_PAGE_SIZE=4096
CONFIG_NORDIC_QSPI_NOR_INIT_PRIORITY=1

CONFIG_SPI_FLASH_LOADER=y

CONFIG_MPU_ALLOW_FLASH_WRITE=y

CONFIG_FILE_SYSTEM=y
CONFIG_FILE_SYSTEM_LITTLEFS=y
CONFIG_LV_Z_USE_FILESYSTEM=y
CONFIG_LV_IMG_CACHE_DEF_SIZE=10

CONFIG_FS_LITTLEFS_FC_HEAP_SIZE=16384
CONFIG_FS_LITTLEFS_NUM_FILES=64

# APDS9306
CONFIG_APDS9306=y
CONFIG_APDS9306_IS_APDS9306_065=y

# NCS External flash
# The sizes here need to match dts
CONFIG_PM_OVERRIDE_EXTERNAL_DRIVER_CHECK=y
CONFIG_PM_PARTITION_REGION_SETTINGS_STORAGE_EXTERNAL=y
CONFIG_PM_PARTITION_SIZE_SETTINGS_STORAGE=0x100000

CONFIG_PM_PARTITION_REGION_LITTLEFS_EXTERNAL=y
CONFIG_PM_PARTITION_SIZE_LITTLEFS=0x200000

CONFIG_NRF_FUEL_GAUGE=y
CONFIG_MFD_NPM1300_INIT_PRIORITY=51
CONFIG_REGULATOR_NPM1300_COMMON_INIT_PRIORITY=52
CONFIG_REGULATOR_NPM1300_INIT_PRIORITY=53

CONFIG_SETTINGS_NVS=y
CONFIG_NVS=y

CONFIG_DEBUG_COREDUMP_BACKEND_OTHER=y

CONFIG_RTC=y
CONFIG_RTC_UPDATE=n
CONFIG_RTC_ALARM=y

# Save som flash temporary
CONFIG_APPLICATIONS_USE_QR_CODE=n
CONFIG_APPLICATIONS_USE_X_RAY=n

CONFIG_STORE_IMAGES_EXTERNAL_FLASH=y
```

## app/boards/log_on_rtt.conf
```kconfig
CONFIG_USE_SEGGER_RTT=y
CONFIG_LOG_BACKEND_RTT=y
CONFIG_LOG_BACKEND_RTT_MODE_BLOCK=y
CONFIG_LOG_BUFFER_SIZE=4096
CONFIG_LOG_BACKEND_RTT_OUTPUT_BUFFER_SIZE=128
CONFIG_LOG_BLOCK_IN_THREAD=y
```

## app/boards/log_on_uart.conf
```kconfig
# Copyright (c) 2025 ZSWatch Project
# SPDX-License-Identifier: Apache-2.0

CONFIG_SERIAL=y
CONFIG_UART_CONSOLE=y
CONFIG_LOG_BACKEND_RTT=n
CONFIG_LOG_BACKEND_UART=y
CONFIG_CONSOLE=y
```

## app/boards/log_on_usb.conf
```kconfig
CONFIG_USB_DEVICE_STACK=y
CONFIG_USB_DEVICE_PRODUCT="ZSWATCH CDC ACM"
CONFIG_USB_DEVICE_PID=0x0001
CONFIG_USB_DRIVER_LOG_LEVEL_ERR=y
CONFIG_USB_DEVICE_LOG_LEVEL_ERR=y
CONFIG_SERIAL=y
CONFIG_UART_INTERRUPT_DRIVEN=y
CONFIG_UART_LINE_CTRL=y
CONFIG_USB_DEVICE_INITIALIZE_AT_BOOT=y
CONFIG_SERIAL=y
CONFIG_UART_CONSOLE=y
CONFIG_LOG_BACKEND_UART=y
CONFIG_CONSOLE=y
CONFIG_LOG_PROCESS_THREAD_STARTUP_DELAY_MS=2000
```

## app/boards/native_posix.conf
```kconfig
CONFIG_ZSWATCH_PCB_REV=3
CONFIG_BT_DIS_HW_REV_STR="3"

CONFIG_FLASH_SIMULATOR=y

CONFIG_I2C=n
CONFIG_PWM=n
CONFIG_SENSOR=n
CONFIG_ADC=n
CONFIG_BMI270_PLUS=n
CONFIG_LIS2MDL=n
CONFIG_LIS2MDL_MAG_ODR_RUNTIME=n
CONFIG_BME680=n
CONFIG_MAX30101=n
CONFIG_APDS9306=n
CONFIG_MAX30101_MULTI_LED_MODE=n
CONFIG_APDS9306=n
CONFIG_PINCTRL=n
CONFIG_TEST_RANDOM_GENERATOR=y
CONFIG_REGULATOR=y

CONFIG_GPIO=y
CONFIG_INPUT=y
CONFIG_INPUT_LONGPRESS=n
CONFIG_INPUT_SDL_TOUCH=y
CONFIG_GPIO_EMUL_SDL=y

CONFIG_RTC=y
CONFIG_RTC_ALARM=y
CONFIG_RTC_EMUL=y

CONFIG_SPI=n
CONFIG_GC9A01=n
CONFIG_INPUT_MODIFIED_CST816S=n
CONFIG_INPUT_CST816S_INTERRUPT=n
CONFIG_REGULATOR_FIXED=n

CONFIG_SDL_DISPLAY_DEFAULT_PIXEL_FORMAT_RGB_565=y

CONFIG_NEWLIB_LIBC=n
CONFIG_NEWLIB_LIBC_FLOAT_PRINTF=n
CONFIG_POSIX_API=n

CONFIG_CONSOLE=y

CONFIG_BLE_DISABLE_PAIRING_REQUIRED=y
CONFIG_THREAD_NAME=y
CONFIG_PRINTK=y

CONFIG_LOG_PRINTK=y
CONFIG_LOG=y
CONFIG_DEBUG_OPTIMIZATIONS=y

CONFIG_SPI_FLASH_LOADER=n

CONFIG_BT_EXT_ADV=n

CONFIG_SDL_DISPLAY_ZOOM_PCT=200
CONFIG_SDL_DISPLAY_USE_HARDWARE_ACCELERATOR=n
CONFIG_LV_Z_FLUSH_THREAD=n


CONFIG_FILE_SYSTEM=y
CONFIG_FILE_SYSTEM_LITTLEFS=y
CONFIG_LV_Z_USE_FILESYSTEM=y

CONFIG_FS_LITTLEFS_FC_HEAP_SIZE=16384
CONFIG_FS_LITTLEFS_NUM_FILES=64
```

## app/boards/native_sim_64.conf
```kconfig
# Copyright (c) 2025 ZSWatch Project
# SPDX-License-Identifier: Apache-2.0

CONFIG_FLASH_SIMULATOR=y
CONFIG_STORE_IMAGES_EXTERNAL_FLASH=n

CONFIG_EMUL=y

CONFIG_I2C=n
CONFIG_PWM=n
CONFIG_SENSOR=y
CONFIG_ADC=n
CONFIG_ZSW_BMI270=n
CONFIG_LIS2MDL=n
CONFIG_LIS2MDL_MAG_ODR_RUNTIME=n
CONFIG_BME680=n
CONFIG_MAX30101=n
CONFIG_APDS9306=y
CONFIG_ZSW_APDS9306_EMUL=y
CONFIG_ZSW_BMP581=y
CONFIG_ZSW_BMP581_EMUL=y
CONFIG_MAX30101_MULTI_LED_MODE=n
CONFIG_PINCTRL=n
CONFIG_TEST_RANDOM_GENERATOR=y
CONFIG_REGULATOR=y

CONFIG_GPIO=y
CONFIG_INPUT=y
CONFIG_INPUT_LONGPRESS=n
CONFIG_INPUT_SDL_TOUCH=y
CONFIG_GPIO_EMUL_SDL=y

CONFIG_RTC=y
CONFIG_RTC_ALARM=y
CONFIG_RTC_EMUL=y

CONFIG_SPI=n
CONFIG_GC9A01=n
CONFIG_INPUT_MODIFIED_CST816S=n
CONFIG_INPUT_CST816S_INTERRUPT=n
CONFIG_REGULATOR_FIXED=n

CONFIG_SDL_DISPLAY_DEFAULT_PIXEL_FORMAT_RGB_565=y

CONFIG_PICOLIBC=n
CONFIG_EXTERNAL_LIBC=y

CONFIG_CONSOLE=y

CONFIG_BLE_DISABLE_PAIRING_REQUIRED=y
CONFIG_THREAD_NAME=y
CONFIG_PRINTK=y

CONFIG_LOG_PRINTK=y
CONFIG_LOG=y
CONFIG_DEBUG_OPTIMIZATIONS=y

CONFIG_SPI_FLASH_LOADER=n

CONFIG_BT_EXT_ADV=n

CONFIG_SDL_DISPLAY_ZOOM_PCT=200
CONFIG_SDL_DISPLAY_USE_HARDWARE_ACCELERATOR=n
CONFIG_LV_Z_FLUSH_THREAD=n


CONFIG_FILE_SYSTEM=y
CONFIG_FILE_SYSTEM_LITTLEFS=y
CONFIG_LV_Z_USE_FILESYSTEM=y

CONFIG_FS_LITTLEFS_FC_HEAP_SIZE=16384
CONFIG_FS_LITTLEFS_NUM_FILES=64

CONFIG_MBEDTLS_HEAP_SIZE=16384

CONFIG_ZCBOR=y

# Mic
CONFIG_ZSW_MIC=y
CONFIG_AUDIO_DMIC_EMUL=y
```

## app/boards/no_rtc.conf
```kconfig
# Copyright (c) 2025 ZSWatch Project
# SPDX-License-Identifier: Apache-2.0

CONFIG_RTC=n
CONFIG_RTC_UPDATE=n
CONFIG_RTC_ALARM=n
```

## app/boards/no_touch.conf
```kconfig
# Copyright (c) 2025 ZSWatch Project
# SPDX-License-Identifier: Apache-2.0

CONFIG_KSCAN_CST816S=n
CONFIG_KSCAN_CST816S_INTERRUPT=n
CONFIG_KSCAN=n
CONFIG_LV_Z_POINTER_KSCAN=n
```

## app/boards/nrf5340dk_nrf5340_cpuapp.conf
```kconfig
#---------------
# FLASH
#-----------------
CONFIG_FLASH=y
CONFIG_FLASH_PAGE_LAYOUT=y
CONFIG_STREAM_FLASH=y
CONFIG_FLASH_MAP=y
CONFIG_NVS=y
CONFIG_NORDIC_QSPI_NOR=y
CONFIG_NORDIC_QSPI_NOR_FLASH_LAYOUT_PAGE_SIZE=4096

CONFIG_MPU_ALLOW_FLASH_WRITE=y

CONFIG_FILE_SYSTEM=y
CONFIG_FILE_SYSTEM_LITTLEFS=y
CONFIG_LV_Z_USE_FILESYSTEM=y

CONFIG_FS_LITTLEFS_FC_HEAP_SIZE=16384

# NCS Partition Manager
# Make sure size matches dts
CONFIG_PM_PARTITION_REGION_SETTINGS_STORAGE_EXTERNAL=y
CONFIG_PM_PARTITION_SIZE_SETTINGS_STORAGE=0x100000
CONFIG_PM_PARTITION_REGION_LITTLEFS_EXTERNAL=y

# BME688 
CONFIG_BME680=y


#---------------
# FLASH
#-----------------
CONFIG_FLASH=y
CONFIG_FLASH_PAGE_LAYOUT=y
CONFIG_STREAM_FLASH=y
CONFIG_FLASH_MAP=y
CONFIG_NVS=y
CONFIG_NORDIC_QSPI_NOR=y
CONFIG_NORDIC_QSPI_NOR_FLASH_LAYOUT_PAGE_SIZE=4096

CONFIG_MPU_ALLOW_FLASH_WRITE=y

CONFIG_FILE_SYSTEM=y
CONFIG_FILE_SYSTEM_LITTLEFS=y
CONFIG_LV_Z_USE_FILESYSTEM=y

CONFIG_FS_LITTLEFS_FC_HEAP_SIZE=16384

CONFIG_PM_PARTITION_REGION_SETTINGS_STORAGE_EXTERNAL=y
CONFIG_PM_PARTITION_SIZE_SETTINGS_STORAGE=0x100000

# Treat nRF5340 dk as a rev 4 due to it mostly being used to indicate
# how external flash shall be utilized. nRF5340dk has QSPI flash, hence
# similar to rev 4.
CONFIG_ZSWATCH_PCB_REV=4

CONFIG_STORE_IMAGES_EXTERNAL_FLASH=y

# NCS External flash
# The sizes here need to match dts
CONFIG_PM_OVERRIDE_EXTERNAL_DRIVER_CHECK=y
CONFIG_PM_PARTITION_REGION_SETTINGS_STORAGE_EXTERNAL=y
CONFIG_PM_PARTITION_SIZE_SETTINGS_STORAGE=0x100000

CONFIG_PM_PARTITION_REGION_LITTLEFS_EXTERNAL=y
CONFIG_PM_PARTITION_SIZE_LITTLEFS=0x200000

CONFIG_DEBUG_COREDUMP_BACKEND_OTHER=y

CONFIG_STORE_IMAGES_EXTERNAL_FLASH=y

# FOTA 
CONFIG_NCS_SAMPLE_MCUMGR_BT_OTA_DFU=y

CONFIG_MCUMGR=y
CONFIG_MCUMGR_TRANSPORT_WORKQUEUE_STACK_SIZE=8096
CONFIG_SHELL=y
CONFIG_CONSOLE=y
CONFIG_MCUMGR_TRANSPORT_UART=y
CONFIG_MCUMGR_GRP_OS=y
CONFIG_MCUMGR_GRP_OS_TASKSTAT=y
CONFIG_MCUMGR_GRP_FS=y
CONFIG_MCUMGR_GRP_SHELL=y

CONFIG_BT_GATT_DYNAMIC_DB=y
CONFIG_MCUMGR_TRANSPORT_BT_DYNAMIC_SVC_REGISTRATION=y
CONFIG_MCUMGR_MGMT_NOTIFICATION_HOOKS=y
CONFIG_MCUMGR_GRP_IMG_UPLOAD_CHECK_HOOK=y
CONFIG_MCUMGR_GRP_IMG_IMAGE_SLOT_STATE_HOOK=y
CONFIG_MCUMGR_GRP_IMG_STATUS_HOOKS=y
CONFIG_MCUMGR_GRP_FS_LOG_LEVEL_DBG=y
# Enable MCUMGR management for both OS and Images
CONFIG_MCUMGR_GRP_OS=y
CONFIG_MCUMGR_GRP_IMG=y

# Configure MCUMGR transport to UART
CONFIG_MCUMGR_TRANSPORT_BT=y

# Dependencies
# Configure dependencies for CONFIG_MCUMGR  
CONFIG_NET_BUF=y
CONFIG_ZCBOR=y
CONFIG_CRC=y

# Configure dependencies for CONFIG_MCUMGR_GRP_IMG  
CONFIG_FLASH=y
CONFIG_IMG_MANAGER=y

# Configure dependencies for CONFIG_IMG_MANAGER  
CONFIG_STREAM_FLASH=y
CONFIG_FLASH_MAP=y

CONFIG_BASE64=y

# Enable Shell with Dummy backend
CONFIG_SHELL=y
CONFIG_SHELL_BACKEND_SERIAL=n
CONFIG_SHELL_BACKEND_DUMMY=y

# Enable MCUmgr and Shell transport
CONFIG_MCUMGR=y
CONFIG_BASE64=y
CONFIG_MCUMGR_TRANSPORT_SHELL=n
CONFIG_MCUMGR_TRANSPORT_DUMMY=y

# mcumgr-cli application doesn't accept log in the channel it uses
CONFIG_SHELL_LOG_BACKEND=n

# XIP
CONFIG_HAVE_CUSTOM_LINKER_SCRIPT=y
CONFIG_CODE_DATA_RELOCATION=y
CONFIG_BUILD_NO_GAP_FILL=y
CONFIG_CUSTOM_LINKER_SCRIPT="linker_arm_extxip.ld"
CONFIG_FLASH_INIT_PRIORITY=40
CONFIG_NORDIC_QSPI_NOR_XIP=y
```

## app/boards/test_mode.conf
```kconfig
# Copyright (c) 2026 ZSWatch Project
# SPDX-License-Identifier: Apache-2.0

CONFIG_ZSW_TEST_SKIP_ONBOARDING=y

CONFIG_ASSERT_VERBOSE=y

# Enable info-level logs for key modules during testing
CONFIG_ZSW_UI_CONTROLLER_LOG_LEVEL_INF=y
CONFIG_ZSW_APP_LOG_LEVEL_INF=y
```

/*
 * Copyright (c) 2023 Jakob Krantz
 *
 * SPDX-License-Identifier: Apache-2.0
 */

/dts-v1/;
#include <nordic/nrf5340_cpuappns_qkaa.dtsi>
#include "zswatch_nrf5340_common.dts"

/ {
	model = "ZSWatch NRF5340 Application";
	compatible = "nordic,zswatch-nrf5340-cpuapp";

	chosen {
		zephyr,sram = &sram0_ns;
		zephyr,flash = &flash0;
		zephyr,code-partition = &slot0_ns_partition;
	};

	aliases {
		watchdog0 = &wdt0;
	};
};

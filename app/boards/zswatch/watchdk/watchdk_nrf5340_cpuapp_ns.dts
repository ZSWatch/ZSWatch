/*
 * Copyright (c) 2025 ZSWatch Project
 * SPDX-License-Identifier: Apache-2.0
 */

/dts-v1/;
#include <nordic/nrf5340_cpuappns_qkaa.dtsi>
#include "nrf5340_cpuapp_common.dtsi"

/ {
    model = "ZSWatch WatchDK nRF5340 Application";
    compatible = "zswatch,zswatch-nrf5340-cpuapp";

    chosen {
        zephyr,sram = &sram0_ns;
        zephyr,flash = &flash0;
        zephyr,code-partition = &slot0_ns_partition;
    };

    aliases {
        watchdog0 = &wdt0;
    };
};

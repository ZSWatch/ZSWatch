/*
 * Copyright (c) 2026 ZSWatch Project
 * SPDX-License-Identifier: Apache-2.0
 */

/ {
    aliases {
        hr-hub = &biometric_hub;
    };
};

&i2c1 {
    clock-frequency = <I2C_BITRATE_FAST>;

    biometric_hub: max32664c@55 {
        compatible = "maxim,max32664c";
        reg = <0x55>;
        status = "okay";
        reset-gpios = <&gpio0 22 GPIO_ACTIVE_HIGH>;
        mfio-gpios = <&gpio0 4 GPIO_ACTIVE_HIGH>;
        hr-config = [00 01];
        spo2-config = [11 21];
        led-current = [3F 3F 3F];
        /* One report per 25 effective samples (1 s), matching the HR UI/cache. */
        report-period = <25>;
        min-sampling-rate = <400>;
        max-sampling-rate = <400>;
        use-max86141;
    };
};

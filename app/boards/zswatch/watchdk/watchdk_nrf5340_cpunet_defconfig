## app/boards/zswatch/watchdk/watchdk_nrf5340_cpunet_defconfig
```kconfig
# Copyright (c) 2025 ZSWatch Project
# SPDX-License-Identifier: Apache-2.0

# Enable MPU
CONFIG_ARM_MPU=y

# Enable hardware stack protection
CONFIG_HW_STACK_PROTECTION=y

# enable GPIO
CONFIG_GPIO=y

# Disable uart driver
CONFIG_SERIAL=n

# disable console
CONFIG_CONSOLE=n
CONFIG_UART_CONSOLE=n

CONFIG_CLOCK_CONTROL_NRF_K32SRC_RC=y

# Ensure GPIO P0.01 and P0.00 can be used
CONFIG_SOC_ENABLE_LFXO=n

# Change the NCS boot string
CONFIG_NCS_APPLICATION_BOOT_BANNER_STRING="WatchDK"
```

## app/boards/zswatch/zswatch_legacy/Kconfig.zswatch_legacy
```kconfig
# Copyright (c) 2022 Zephyr Project members and individual contributors
# SPDX-License-Identifier: Apache-2.0

config BOARD_ZSWATCH_LEGACY
	select SOC_NRF5340_CPUAPP_QKAA if BOARD_ZSWATCH_LEGACY_NRF5340_CPUAPP
	select SOC_NRF5340_CPUAPP_QKAA if BOARD_ZSWATCH_LEGACY_NRF5340_CPUAPP_NS
	select SOC_NRF5340_CPUNET_QKAA if BOARD_ZSWATCH_LEGACY_NRF5340_CPUNET
```

## app/boards/zswatch/zswatch_legacy/board.yml
```yaml
# Copyright (c) 2025 ZSWatch Project
# SPDX-License-Identifier: Apache-2.0

board:
  name: zswatch_legacy
  vendor: zswatch
  socs:
  - name: 'nrf5340'
    variants:
    - name: 'ns'
      cpucluster: 'cpuapp'
  revision:
    format: number
    default: "5"
    exact: false
    revisions:
    - name: "4"
    - name: "5"
```

## app/boards/zswatch/zswatch_legacy/zswatch_legacy_nrf5340_cpuapp_ns_defconfig
```kconfig
# SPDX-License-Identifier: Apache-2.0

# Enable MPU
CONFIG_ARM_MPU=y

# Enable hardware stack protection
CONFIG_HW_STACK_PROTECTION=y

# Enable TrustZone-M
CONFIG_ARM_TRUSTZONE_M=y

# This Board implies building Non-Secure firmware
CONFIG_TRUSTED_EXECUTION_NONSECURE=y

# enable GPIO
CONFIG_GPIO=y

# Disable uart driver
CONFIG_SERIAL=n

# disable console
CONFIG_CONSOLE=n
CONFIG_UART_CONSOLE=n

CONFIG_CLOCK_CONTROL_NRF_K32SRC_RC=y
```

## app/boards/zswatch_legacy_nrf5340_cpuapp_5.conf
```kconfig
# Copyright (c) 2025 ZSWatch Project
# SPDX-License-Identifier: Apache-2.0

CONFIG_NRF_FUEL_GAUGE=y
CONFIG_MFD_NPM13XX_INIT_PRIORITY=51
CONFIG_REGULATOR_NPM13XX_COMMON_INIT_PRIORITY=52
CONFIG_REGULATOR_NPM13XX_INIT_PRIORITY=53

CONFIG_RTC=y
CONFIG_RTC_UPDATE=n
CONFIG_RTC_ALARM=y

# Enable USB subsystem
CONFIG_USB_DEVICE_STACK=y
CONFIG_SERIAL=y
CONFIG_UART_LINE_CTRL=y
CONFIG_USB_DEVICE_INITIALIZE_AT_BOOT=n
CONFIG_USB_DEVICE_PRODUCT="ZSWatch"

# Shell configuration
CONFIG_SHELL_VT100_COMMANDS=n
CONFIG_SHELL_PROMPT_DUMMY="zsw:~$ "
CONFIG_SHELL_BACKEND_DUMMY_BUF_SIZE=1024
CONFIG_SHELL_HELP_ON_WRONG_ARGUMENT_COUNT=n

# Enable MCUmgr and Shell transport also over UART (CDC_ACM/USB)
CONFIG_MCUMGR_TRANSPORT_UART=y
CONFIG_MCUMGR_TRANSPORT_WORKQUEUE_STACK_SIZE=8096

# mcumgr-cli application doesn't accept log in the channel it uses
CONFIG_SHELL_LOG_BACKEND=n

# FOTA
CONFIG_ZSW_FW_UPDATE=y

# XIP
CONFIG_ZSW_XIP=y
CONFIG_CUSTOM_LINKER_SCRIPT="linker_arm_extxip.ld"

# Microphone
CONFIG_ZSW_MIC=y
CONFIG_USE_SEGGER_RTT=y # Remove later when we have a proper audio output
```

## app/boards/zswatch_nrf5340_cpuapp_3.conf
```kconfig
#---------------
# FLASH
#-----------------
CONFIG_FLASH=y
CONFIG_FLASH_PAGE_LAYOUT=y
CONFIG_STREAM_FLASH=y
CONFIG_FLASH_MAP=y
CONFIG_NVS=y
CONFIG_SPI_NOR=y
CONFIG_SPI_NOR_SFDP_RUNTIME=n
# Don't put the flash to sleep until unused for 10s
CONFIG_SPI_NOR_ACTIVE_DWELL_MS=10000
CONFIG_SPI_NOR_FLASH_LAYOUT_PAGE_SIZE=4096

CONFIG_SPI_FLASH_LOADER=y

CONFIG_MPU_ALLOW_FLASH_WRITE=y

CONFIG_FILE_SYSTEM=y
CONFIG_FILE_SYSTEM_LITTLEFS=y
CONFIG_LV_Z_USE_FILESYSTEM=y

CONFIG_FS_LITTLEFS_FC_HEAP_SIZE=16384

# APDS9306
CONFIG_APDS9306=y
CONFIG_APDS9306_IS_APDS9306_065=y

# NCS External flash
# The sizes here need to match dts
CONFIG_PM_OVERRIDE_EXTERNAL_DRIVER_CHECK=y
CONFIG_PM_PARTITION_REGION_SETTINGS_STORAGE_EXTERNAL=y
CONFIG_PM_PARTITION_SIZE_SETTINGS_STORAGE=0x100000

CONFIG_PM_PARTITION_REGION_LITTLEFS_EXTERNAL=y
CONFIG_PM_PARTITION_SIZE_LITTLEFS=0x200000

CONFIG_DEBUG_COREDUMP_BACKEND_OTHER=y

# Save flash
CONFIG_WATCHFACE_MINIMAL=n
CONFIG_APPLICATIONS_USE_2048=n
CONFIG_APPLICATIONS_USE_COMPASS=n

CONFIG_STORE_IMAGES_EXTERNAL_FLASH=y
```

## app/boards/zswatch_nrf5340_cpuapp_4.conf
```kconfig
#---------------
# FLASH
#-----------------
CONFIG_NORDIC_QSPI_NOR=y
CONFIG_NORDIC_QSPI_NOR_FLASH_LAYOUT_PAGE_SIZE=4096
CONFIG_NORDIC_QSPI_NOR_INIT_PRIORITY=1

# NCS External flash
# The sizes here need to match dts
CONFIG_PM_PARTITION_SIZE_SETTINGS_STORAGE=0x100000
CONFIG_PM_PARTITION_SIZE_LITTLEFS=0x200000

# FOTA 
CONFIG_ZSW_FW_UPDATE=y

# Shell
CONFIG_SHELL=y
CONFIG_SHELL_BACKEND_SERIAL=n
CONFIG_SHELL_BACKEND_DUMMY=y

# Enable MCUmgr and Shell transport
CONFIG_MCUMGR_TRANSPORT_WORKQUEUE_STACK_SIZE=8096
CONFIG_MCUMGR_TRANSPORT_SHELL=n
CONFIG_MCUMGR_TRANSPORT_DUMMY=y

# mcumgr-cli application doesn't accept log in the channel it uses
CONFIG_SHELL_LOG_BACKEND=n

# XIP
CONFIG_ZSW_XIP=y
CONFIG_CUSTOM_LINKER_SCRIPT="linker_arm_extxip.ld"
```

## app/boards/zswatch_nrf5340_cpuapp_5.conf
```kconfig
CONFIG_NRF_FUEL_GAUGE=y
CONFIG_MFD_NPM1300_INIT_PRIORITY=51
CONFIG_REGULATOR_NPM1300_COMMON_INIT_PRIORITY=52
CONFIG_REGULATOR_NPM1300_INIT_PRIORITY=53

CONFIG_RTC=y
CONFIG_RTC_UPDATE=n
CONFIG_RTC_ALARM=y

# Enable USB subsystem
CONFIG_USB_DEVICE_STACK=y
CONFIG_SERIAL=y
CONFIG_UART_LINE_CTRL=y
CONFIG_USB_DEVICE_INITIALIZE_AT_BOOT=n

CONFIG_SHELL=y
CONFIG_SHELL_STACK_SIZE=4096
CONFIG_MCUMGR_TRANSPORT_WORKQUEUE_STACK_SIZE=8096
CONFIG_SHELL_BACKEND_SERIAL=y
CONFIG_MCUMGR_TRANSPORT_SHELL=y

# mcumgr-cli application doesn't accepts log in the channel it uses
CONFIG_SHELL_LOG_BACKEND=n

CONFIG_CONSOLE=y
CONFIG_UART_CONSOLE=y
CONFIG_UART_CONSOLE_MCUMGR=y
CONFIG_SHELL_BACKEND_DUMMY=y

# FOTA 
CONFIG_ZSW_FW_UPDATE=y

# Enable MCUmgr and Shell transport
CONFIG_MCUMGR_TRANSPORT_WORKQUEUE_STACK_SIZE=8096

# mcumgr-cli application doesn't accept log in the channel it uses
CONFIG_SHELL_LOG_BACKEND=n

# XIP
CONFIG_ZSW_XIP=y
CONFIG_CUSTOM_LINKER_SCRIPT="linker_arm_extxip.ld"
```

## app/drivers/Kconfig
```kconfig
# Copyright (c) 2025 ZSWatch Project
# SPDX-License-Identifier: Apache-2.0

menu "Custom drivers"
    rsource "display/Kconfig"
    rsource "input/Kconfig"
    rsource "sensor/Kconfig"
    rsource "audio/Kconfig"
endmenu
```

## app/drivers/audio/Kconfig
```kconfig
# Copyright (c) 2025 ZSWatch Project
# SPDX-License-Identifier: Apache-2.0

# Audio drivers

rsource "Kconfig.dmic_emul"
```

## app/drivers/audio/Kconfig.dmic_emul
```kconfig
# DMIC Emulator Driver Configuration

config AUDIO_DMIC_EMUL
	bool "DMIC Emulator Driver"
	default n
	depends on AUDIO_DMIC
	help
	  Enable DMIC emulator driver for testing DMIC applications
	  on platforms without real DMIC hardware. The driver generates
	  a configurable sine wave for testing purposes.

if AUDIO_DMIC_EMUL

module = DMIC_EMUL
module-str = dmic_emul
source "subsys/logging/Kconfig.template.log_config"

endif # AUDIO_DMIC_EMUL
```

## app/drivers/display/Kconfig
```kconfig
# Copyright (c) 2025 ZSWatch Project
# SPDX-License-Identifier: Apache-2.0

if DISPLAY
    rsource "gc9a01/Kconfig"
endif
```

## app/drivers/display/Kconfig.gc9a01
```kconfig
# GC9A01 display controller configuration options

config GC9A01
	bool "GC9A01 compatible display controller driver"
	default n
	select SPI
	help
	  Enable driver for GC9A01 compatible controller.
```

## app/drivers/display/gc9a01/Kconfig
```kconfig
# Copyright (c) 2025 ZSWatch Project
# SPDX-License-Identifier: Apache-2.0

menuconfig GC9A01
    bool "GC9A01 Display"
    default n
    select SPI
    help
        Enable driver for GC9A01 compatible controller.
```

## app/drivers/input/Kconfig
```kconfig
# Copyright (c) 2025 ZSWatch Project
# SPDX-License-Identifier: Apache-2.0

if INPUT

	config INPUT_NPM13XX
		bool "NPM1300 SHIPHOLD button input driver"
		default y
		depends on MFD_NPM13XX
		help
			Enable input driver for NPM1300 SHIPHOLD button events.
			Forwards NPM1300 SHIPHOLD events into Zephyr's input subsystem.

endif
```

## app/drivers/input/cst816s/Kconfig
```kconfig
# Copyright (c) 2025 ZSWatch Project
# Copyright (c) 2020 Qingsong Gou <gouqs@hotmail.com>
# Copyright (c) 2022 Jakob Krantz <mail@jakobkrantz.se>
# SPDX-License-Identifier: Apache-2.0

menuconfig INPUT_MODIFIED_CST816S
	bool "CST816S Capacitive touch panel driver"
	default y
	depends on DT_HAS_HYNITRON_CST816S_ENABLED
	select I2C
	help
	  Enable modified out of tree driver for hynitron cst816s touch panel.

if INPUT_MODIFIED_CST816S

config INPUT_CST816S_PERIOD
	int "Sample period"
	depends on !INPUT_CST816S_INTERRUPT
	default 20
	help
	  Sample period in milliseconds when in polling mode.

config INPUT_CST816S_INTERRUPT
	bool "Interrupt support"
	default y
	depends on GPIO
	help
	  Enable interrupt support (requires GPIO).

endif
```

## app/drivers/sensor/Kconfig
```kconfig
# Copyright (c) 2025 ZSWatch Project
# SPDX-License-Identifier: Apache-2.0

if SENSOR
	rsource "bmp581/Kconfig"
	rsource "bmi270/Kconfig"
	rsource "apds9306/Kconfig"
endif
```

## app/drivers/sensor/apds9306/Kconfig
```kconfig
# Copyright (c) 2025 ZSWatch Project
# SPDX-License-Identifier: Apache-2.0

if APDS9306

config ZSW_APDS9306_EMUL
	bool "Emulate an Avago APDS9306 light sensor"
	default y
	depends on EMUL
	depends on APDS9306
	help
	  This is an emulator for the Avago APDS9306 light sensor.

	  It provides readings which follow a simple sequence, thus allowing
	  test code to check that things are working as expected.

endif #APDS9306
```

## app/drivers/sensor/bme68x_iaq/Kconfig
```kconfig
# BME68x encironmental sensor configuration options.

#
# Copyright (c) 2023, Nordic Semiconductor
# Copyright (c) 2023, Daniel Kampert
#
# SPDX-License-Identifier: LicenseRef-Nordic-5-Clause
#

config BME68X_EXT_IAQ
	bool "Bosch BSEC library"
	depends on !BME680
	depends on SETTINGS && !SETTINGS_NONE
	depends on I2C
	help
	  Enable the use of Bosch BSEC library.
	  This configuration depends on the BME680 Zephyr driver being disabled.

if BME68X_EXT_IAQ

config BME68X_IAQ_SAVE_INTERVAL_MINUTES
	int "Period in minutes after which BSEC state is saved to flash"
	default 60

config BME68X_IAQ_THREAD_STACK_SIZE
	int "BSEC thread stack size"
	default 4096

config BME68X_IAQ_TEMPERATURE_OFFSET
	int "BSEC temperature offset in centidegrees"
	default 0
	help
	  BSEC temperature offset. To account for external heat sources on the board.
	  The actual value is divided by 100. This is due to the Kconfig parser
	  not supporting floating point types.
	  The default value 200 is translated to 2.0 degrees celsius offset.

choice BME68X_IAQ_SAMPLE_RATE
	prompt "Bosch BSEC sample mode"
	default BME68X_IAQ_SAMPLE_RATE_LOW_POWER
	help
	  Configuration that sets how often sensor data is sampled from the BSEC library.
	  Each mode corresponds an internal preset that decides how often data is sampled from the
	  BME680.

config BME68X_IAQ_SAMPLE_RATE_ULTRA_LOW_POWER
	bool "BSEC low ultra power mode"
	help
	  Sample data from BSEC severy 300 seconds.

config BME68X_IAQ_SAMPLE_RATE_LOW_POWER
	bool "BSEC low power mode"
	help
	  Sample data from BSEC every 3 seconds.

config BME68X_IAQ_SAMPLE_RATE_CONTINUOUS
	bool "BSEC continuous mode"
	help
	  Sample data from BSEC every second.
	  This is a particularly power-hungry sample mode that should only be considered for
	  testing purposes.

endchoice

module = BME68X_IAQ
module-str = BME68X_IAQ
source "subsys/logging/Kconfig.template.log_config"

endif
```

## app/drivers/sensor/bmi270/Kconfig
```kconfig
# Copyright (c) 2025 ZSWatch Project
# SPDX-License-Identifier: Apache-2.0

menuconfig ZSW_BMI270
    bool "Bosch BMI270 Sensor"
    depends on DT_HAS_ZSWATCH_BMI270_ENABLED
    default y
    select I2C
    help
      Enable the advanced driver for the BMI270 IMU.

if ZSW_BMI270
    config ZSW_BMI270_THREAD_STACK_SIZE
        int "Sensor delayed work thread stack size"
        depends on ZSW_BMI270_TRIGGER_OWN_THREAD
        default 1024

    config ZSW_BMI270_THREAD_PRIORITY
        int "BMI270-Plus thread priority"
        depends on ZSW_BMI270_TRIGGER_OWN_THREAD
        default 10

    choice
        prompt "BMI270 trigger mode"
        default ZSW_BMI270_TRIGGER_NONE

        config ZSW_BMI270_TRIGGER_NONE
            bool "No trigger"
            help
                Disable the trigger interface.

        config ZSW_BMI270_TRIGGER_GLOBAL_THREAD
            depends on GPIO
            select ZSW_BMI270_TRIGGER
            bool "Use workqueue"
            help
                Use the global workqueue to process the interrupts from the BMI270.

        config ZSW_BMI270_TRIGGER_OWN_THREAD
            depends on GPIO
            select ZSW_BMI270_TRIGGER
            bool "Use driver thread"
            help
                Use a separate thread to process the interrupts from the BMI270.
    endchoice

    config ZSW_BMI270_USE_INT1
        bool "Use INT1 pin instead of INT2"
        depends on ZSW_BMI270_TRIGGER
        help
            Enable the use of the INT1 pin for interrupts instead of INT2.
            This is useful for hardware designs where only INT1 is connected.

    config ZSW_BMI270_TRIGGER
        bool

module = ZSW_BOSCH_BMI270
module-str = ZSW_BOSCH_BMI270
source "subsys/logging/Kconfig.template.log_config"

endif
```

## app/drivers/sensor/bmp581/Kconfig
```kconfig
# Copyright (c) 2025 ZSWatch Project
# SPDX-License-Identifier: Apache-2.0

menuconfig ZSW_BMP581
    bool "Bosch BMP581 Sensor"
    depends on DT_HAS_ZSWATCH_BMP581_ENABLED
    default y
    select I2C
    help
      Enable the driver for the BMP581 pressure sensor.

if ZSW_BMP581
    config ZSW_BMP581_EMUL
        bool "Emulate a Bosch BMP581 pressure sensor"
        default y
        depends on EMUL
        depends on ZSW_BMP581
        help
          This is an emulator for the Bosch BMP581 pressure sensor.

          It provides readings which follow a simple sequence, thus allowing
          test code to check that things are working as expected.

    module = ZSW_BOSCH_BMP581
    module-str = ZSW_BOSCH_BMP581
    source "subsys/logging/Kconfig.template.log_config"

endif
```

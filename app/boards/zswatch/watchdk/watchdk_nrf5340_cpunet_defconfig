## app/src/applications/Kconfig
```kconfig
# ZSWatch board configuration

# Copyright (c) 2025 ZSWatch Project
# SPDX-License-Identifier: Apache-2.0

menu "Applications"
    config APPLICATIONS_USE_2048
        bool
        prompt "Activate the application '2048'"
        default y

    config APPLICATIONS_USE_ACCELEROMETER
        bool
        prompt "Activate the application 'Accelerometer'"
        default y

    config APPLICATIONS_USE_INFO
        bool
        prompt "Activate the application 'Info'"
        default y

    config APPLICATIONS_USE_QR_CODE
        bool
        prompt "Activate the application 'QR-Code'"
        default y if LV_Z_USE_FILESYSTEM

    config APPLICATIONS_USE_X_RAY
        bool
        prompt "Activate the application 'X-Ray'"
        default y if LV_Z_USE_FILESYSTEM

    config APPLICATIONS_USE_ZDS
        bool
        prompt "Activate the application 'ZDS'"
        default n
        select APPLICATIONS_USE_ACCELEROMETER

    config APPLICATIONS_USE_CHRONOS
        bool
        prompt "Activate the application 'Chronos'"
        default y

    config APPLICATIONS_USE_DA7212_TEST
        bool
        prompt "Activate the application 'DA7212 Test'"
        default n
        depends on I2S && AUDIO_CODEC

    rsource "watchface/Kconfig"
    rsource "settings/Kconfig"
    rsource "notification/Kconfig"
    rsource "trivia/Kconfig"
    rsource "ppt_remote/Kconfig"
    rsource "compass/Kconfig"
    rsource "sensors_summary/Kconfig"
    rsource "voice_memo/Kconfig"
    rsource "lea_assistant/Kconfig"

    config APPLICATIONS_USE_LEA_ASSISTANT
        bool
        prompt "Activate the application 'LE Audio Assistant'"
        select BT_CENTRAL
        select UTF8
        select BT_EXT_ADV
        select BT_PER_ADV_SYNC
        select BT_ISO_SYNC_RECEIVER
        select BT_GATT_CLIENT
        select BT_GATT_AUTO_DISCOVER_CCC
        select BT_GATT_AUTO_UPDATE_MTU
        select BT_OBSERVER
        select BT_BONDABLE
        select BT_AUDIO
        select BT_BAP_BROADCAST_ASSISTANT
        default n
endmenu
```

## app/src/applications/chronos/Kconfig
```kconfig
# Copyright (c) 2025 ZSWatch Project
# SPDX-License-Identifier: Apache-2.0

module = ZSW_CHRONOS_APP
module-str = ZSW_CHRONOS_APP
source "subsys/logging/Kconfig.template.log_config"
```

/*
 * Copyright (c) 2025 ZSWatch Project
 * SPDX-License-Identifier: Apache-2.0
 */

&bt_hci_controller {
    status = "disabled";
};

&bt_hci_sdc {
    status = "okay";
};

/ {
    chosen {
        zephyr,bt-hci = &bt_hci_sdc;
    };
};

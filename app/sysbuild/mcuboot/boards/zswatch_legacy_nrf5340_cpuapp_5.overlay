/*
 * Copyright (c) 2025 ZSWatch Project
 * SPDX-License-Identifier: Apache-2.0
 */

&uart0 {
    status = "disabled";
};

&bmi270 {
	status = "disabled";
};

&npm1300_pmic {
	status = "disabled";
};

&npm1300_gpio {
	status = "disabled";
};
